// filename : adpESPN.cpp
//========================================================
// 通信アダプタ：ＥＳＰ－ＮＯＷ
//（コールバック・クライアント追跡あり）
//--------------------------------------------------------
//【目的】
// リクエストに従い、ＭＭＰコマンドを実行して、
// 結果をレスポンスする。
//--------------------------------------------------------
//【処理機能】
//・パケット処理なので１スロットを使いまわす。
//・コールバックによるイベントでリクエストをキューイングする。
//--------------------------------------------------------
// Ver 1.2.0 (2026/08/25) 
// ・EPSON-NOWを通信アダプタに追加
//========================================================
#pragma once
//┬
//■┐インクルード
  //■┐Arduinoシステム
    //■ESP-NOW関連
    #include <WiFi.h>
    #include <esp_now.h>
    //│
    //■キューイング関連
    #include <Arduino.h>
    #include <queue>
    #include <mutex>
    //┴
  //│
  //■ＭＭＰシステム
  #include "adp.h"  // 通信アダプタ共通へ公開
  //┴
//┴

//########################################################
//# 専用名の前空間
//########################################################
namespace adpESPN {
//========================================================
// Ａ．基本情報
//========================================================
  //─────────────────
  // 固有データ
  //─────────────────
  const int  ROUTE_ID = ROUTE_ID_ESPN; // ＥＳＰ－ＮＯＷ
        bool ENABLED  = false        ; // 有効性：{有効：true|無効：false}

  //─────────────────
  // 使用するサービス
  //─────────────────
  // ・ESP-NOW

//========================================================
// Ｂ．レスポンス
//========================================================
  void SEND_CONN(const uint8_t* argClientID){
    //┬
    //○メッセージをレスポンス
    esp_now_send(
        argClientID                       , // 送信先MACアドレス
        (const uint8_t*)ctx.resMSG.c_str(), // 送信データ
        ctx.resMSG.length() + 1             // 送信データ長
    );
    //│
    //●ログ出力
    F_SHOW_LOG();
    //┴
  } /* SEND_CONN() */

//========================================================
// Ｃ．リクエスト管理
//========================================================
  //─────────────────
  // 基本情報
  //─────────────────
  struct myQueue {
    uint8_t connMAC[6]; // MACアドレス
    String  connRX    ; // 受信バッファ
  };
  static std::queue<myQueue> QUEUE      ; // キューバッファ
  static std::mutex          QUEUE_MUTEX; // 別スレッドとの衝突回避用のロック

  //─────────────────
  // リクエストの取出
  //----------------------------------
  // 引数：
  // ・キュー受取用の変数
  //----------------------------------
  // 戻り値：キューの有無（論理値）
  // ・true ：あり
  // ・false：なし
  //─────────────────
  bool popQueue(myQueue &argData) {
    //┬
    //○別スレッドとの衝突回避用のロック
    std::lock_guard<std::mutex> lock(QUEUE_MUTEX);
    //│
    //○キューの容量を確認
    if (QUEUE.empty()) return false;
    //│＼（通信デバイスが起動していない場合）
    //│ ▼返却：なし
    //│
    //○先頭を抽出
    //○先頭を削除
    //▼返却：あり
    argData = QUEUE.front();
    QUEUE.pop();
     return true;
  } /* popQueue() */

  //─────────────────
  // リクエストの登録
  //----------------------------------
  // コールバック関数として機能
  //─────────────────
  void ON_RECIVE(
    const esp_now_recv_info_t *recv_info,
    const uint8_t *payload,
    int length
  ) {
    //┬
    //○未取り込みデータを受信
    if (recv_info == nullptr || payload == nullptr || length < 1) return;
    //│＼（空の場合）
    //│ ▼終了：早期リターン
    //│
    //○送信元MACアドレスを取得
    uint8_t mac[6];
    memcpy(mac, recv_info->src_addr, 6);
    //│
    //○受信データをキューに追加
    std::lock_guard<std::mutex> lock(QUEUE_MUTEX);
    myQueue pkt;
    memcpy(pkt.connMAC, mac, 6);
    pkt.connRX = String((const char*)payload, length);
    QUEUE.push(pkt);
    //│
    //▼終了：早期リターン
    return;
  } /* ON_RECIVE() */

//========================================================
// Ｄ．公開機能
//========================================================
  //━━━━━━━━━━━━━━━━━
  // 初期化処理
  //━━━━━━━━━━━━━━━━━
  void START() {
    //┬
    //○サービスを開始
    if (esp_now_init() != ESP_OK) {
    //│＼（通信デバイスが起動していない場合）
        //○起動ログを表示（異常終了）
        //○アダプタを無効化
        //▼終了：早期リターン
        Serial.println("　[NG ] ESP-NOW -> 初期化失敗");
        ENABLED = false;
        return;
    } /* END-if */
    esp_now_register_recv_cb(ON_RECIVE); // コールバック関数登録
    //│
    //○アダプタを有効化
    ENABLED = true; 
    Serial.println("　[OK] ESP-NOW");
    //┴
  } /* START() */

  //━━━━━━━━━━━━━━━━━
  // ハンドラ入口（ポーリング入口）
  //━━━━━━━━━━━━━━━━━
  void HANDLE(){
    //┬
    //○起動チェック
    if (!ENABLED) return; // 初期化済み
    //│＼（このアダプタが無効の場合）
    //│ ▼終了：早期リターン
    //│
    //◎┐ルーティングを指示
    myQueue popDat;
    while (popQueue(popDat)) {
      //│＼（キューが空の場合）
      //│ ▼BREAK：ルーティングを終了
      //│
      //●キュー情報をワークにセット
      F0_SETUP(popDat.connRX);
      //│
#if defined(MMP_TYPE_MAIN) // --┨ＭＭＰ本体┠----┐
      //○リクエストをデータ項目に分解
      F3_SET_ACD_CPATH();
      //│
      //●認証処理を実施
      if (F4_CHECK_AUTH()){SEND_CONN(popDat.connMAC); continue;}
      //│＼（処理継続が不可の場合）
      //│ ●エラーをレスポンス
      //│ ▽次へ：次のキューを走査
#endif // ----------------------------------------┘
      //│
      //●コマンド実行
      F5_RUN();
      //│
      //●実行結果をレスポンス
      SEND_CONN(popDat.connMAC);
      //┴
    } /* END-while */
    //┴
  } /* HANDLE() */

} /* namespace adpESPN */