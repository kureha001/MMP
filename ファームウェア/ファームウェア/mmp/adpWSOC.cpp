// filename : adpWSOC.cpp
//========================================================
// 通信アダプタ：ＷｅｂＳｏｃｋｅｔ
//--------------------------------------------------------
//【目的】
// WebSocket通信を受け付け、
// MMPコマンドを実行して、結果をレスポンスする。
//--------------------------------------------------------
//【処理機能】
//・パケット処理なので１スロットを使いまわす。
//・コールバックによるイベントでリクエストをキューイングする。
//--------------------------------------------------------
// Ver 1.2.0 (2026/08/25) 
// ・全体のロジックをシンプル化
//========================================================
#pragma once
//┬
//■┐インクルード
  //■Arduinoシステム
  #include <WebSocketsServer.h>
  #include <Arduino.h>
  #include <queue>
  #include <mutex>
  //│
  //■ＭＭＰシステム
  #include "adp.h"
  //┴
//┴

//########################################################
//# 専用名前空間
//########################################################
namespace adpWSOC {
//========================================================
// Ａ．基本情報
//========================================================
  //─────────────────
  // 固有データ
  //─────────────────
  const int  ROUTE_ID = ROUTE_ID_WSOC; // ルートID
  const int  SS_SLOTS = 1            ; // 固定スロット(1個を使いまわし)
        bool ENABLED  = false        ; // 有効性：{有効：true|無効：false}

  //─────────────────
  // 使用するサービス
  //─────────────────
  static WebSocketsServer* ADP_SRV = nullptr; // WebSocketサーバ
  static int               SRV_PORT = 8082  ; // ポート番号

  //─────────────────
  // 接続スロット
  //─────────────────
  struct T_SS_SLOT{
    SS_SLOT_TYPE Base        ; // 基本メンバ
    uint8_t      connNum = 0 ; // 接続中のWebSocketクライアント番号
    String       connRX  = ""; // 受信バッファ
  };
  static T_SS_SLOT* ssTBL = nullptr;

  //─────────────────
  // キューイング
  //─────────────────
  struct myQueue {
    uint8_t connNum; // クライアント番号
    String  connRX ; // 受信バッファ
  };
  static std::queue<myQueue> QUEUE      ; // キューバッファ
  static std::mutex          QUEUE_MUTEX; // 別スレッドとの衝突回避用のロック

//========================================================
// Ｂ．接続管理
//========================================================
  //─────────────────
  // 初期化
  //----------------------------------
  // 引数：(参照)接続管理スロット
  //─────────────────
  void SS_INI_SLOT(T_SS_SLOT& argSlot){}
  // ➡【該当処理なし】

  //─────────────────
  // 空きSID取得
  //----------------------------------
  // 戻り値：スロットID
  // ・0,1,2...：空きスロットのID
  // ・-1：空きスロットが無い
  //─────────────────
  int SS_GET_FREE_ID(){return -1;}
  // ➡【該当処理なし】

  //─────────────────
  // 動的アタッチ
  //----------------------------------
  // 戻り値 ：処理結果（論理値）
  // ・false：正常
  // ・true ：異常
  //─────────────────
  bool SS_ATTACH(){return true;}
  // ➡【該当処理なし】

 //========================================================
// Ｃ．レスポンス
//========================================================
  //─────────────────
  // WebSocketへ送信
  //----------------------------------
  // 引数：(参)接続管理スロット
  //─────────────────
  void SEND_CONN(
    T_SS_SLOT&    argSS,
    const String& argMSG
  ){
    //┬
    //●ログ出力
    if (ctx.sysLog >= 0) F_SHOW_LOG(argMSG);
    //│
    //○メッセージをレスポンス
    if (ADP_SRV) ADP_SRV->sendTXT(argSS.connNum, argMSG.c_str());
    //┴
  } /* SEND_CONN() */

//========================================================
// Ｄ．プロセス部品
//========================================================
  //─────────────────
  // １．フレームを取得
  //----------------------------------
  // 戻り値：フレーム作成状況（論理値）
  // ・true ：未完成
  // ・false：完成
  //----------------------------------
  //【データ受信方式】
  // ・取得単位  ：パケット
  // ・データ受信：サーバ(参照) pCharacteristic->getValue()
  //─────────────────
  bool P1_MAKE_FRAME(T_SS_SLOT& argSS){
    //┬
    //○受信データからフレームを作成
    ctx.strFrame = argSS.connRX;
    //│
    //●フレームをURI形式に変換
    F2_FORMAT_URI(ctx.strFrame);
    //│
    //▼返却：フレームの作成状況
    return (ctx.strFrame == "" ? true : false);
  } /* P1_MAKE_FRAME() */

  //─────────────────
  // ２．基本情報を取得
  //─────────────────
  void P2_MAKE_INFO(){
    //┬
    //〇フレームの内容をもとに認証CD・コマンドパスにセット
    F3_SET_ACD_CPATH();
    //┴
  } /* P2_MAKE_INFO() */

  //─────────────────
  // ３．認証を実施
  //----------------------------------
  // 戻り値：認証結果（論理値）
  // ・false： 処理継続が可能
  // ・true ： 処理継続が不可
  //─────────────────
  bool P3_AUTH(T_SS_SLOT& argSS){
    //┬
    //●認証処理を実施
    if (F4_CHECK_AUTH()){SEND_CONN(argSS, ctx.errMSG); return true;}
    //│＼（処理継続が不可の場合）
    //│ ●エラーをレスポンス
    //│ ▼返却：処理継続が不可
    //│
    //▼返却：処理継続が可能
    return false;
  } /* P3_AUTH() */

  //─────────────────
  // ４．MMPコマンドを実行
  //─────────────────
  void P4_RUN_COMMAND(T_SS_SLOT& argSS){
    //┬
    //●MMPコマンドを実行
    String resMMP = F5_RUN();
    //│
    //●実行結果をレスポンス
    SEND_CONN(argSS, resMMP);
    //┴
  } /* P4_RUN_COMMAND() */

//========================================================
// Ｅ．ルーティング処理
//========================================================
  //─────────────────
  // １．MMPコマンド
  //─────────────────
  void routeMMP(T_SS_SLOT& argSS){
    //┬
    //●１．フレームを取得
    if (P1_MAKE_FRAME(argSS)) return;
    //│＼（未完成の場合）
    //│ ▼終了：早期リターン
    //│
#if defined(MMP_TYPE_MAIN) // --┨ＭＭＰ本体┠----┐
    //○２．基本情報を取得
    P2_MAKE_INFO();
    //│
    //○３．ユーザ認証を実施
    if (P3_AUTH(argSS)) return;
    //│＼（処理継続が不可の場合）
    //│ ▼終了：早期リターン
#endif // ----------------------------------------┘
    //│
    //●４．MMPコマンドを実行
    P4_RUN_COMMAND(argSS);
    //┴
  } /* routeMMP() */

//========================================================
// Ｆ．初期化・ポーリング用ハンドル
//========================================================
  //━━━━━━━━━━━━━━━━━
  // コールバック：クライアント用
  //━━━━━━━━━━━━━━━━━
  void webSocketEvent(
    uint8_t   num,
    WStype_t  type,
    uint8_t * payload,
    size_t    length
  ){
    //┬
    //○イベントの種類を確認
    if(type !=WStype_TEXT) return;
    //│＼（テキスト以外の場合）
    //│ ▼終了：早期リターン
    //│
    //○未取り込みデータを受信
    if (payload == nullptr || length < 1) return;
    //│＼（空の場合）
    //│ ▼終了：早期リターン
    //│
    //○受信データをキューに追加
    std::lock_guard<std::mutex> lock(QUEUE_MUTEX);
    QUEUE.push({num, String((char*)payload)});
    //┴
  } /* webSocketEvent() */

  //─────────────────
  // キューの取り出し
  //----------------------------------
  // 引数：
  // ・キュー受取用の変数
  //----------------------------------
  // 戻り値：キューの有無（論理値）
  // ・true ：あり
  // ・false：なし
  //─────────────────
  bool popQueue(myQueue &argData) {
    //┬
    //○別スレッドとの衝突回避用のロック
    std::lock_guard<std::mutex> lock(QUEUE_MUTEX);
    //│
    //○キューの容量を確認
    if (QUEUE.empty()) return false;
    //│＼（通信デバイスが起動していない場合）
    //│ ▼返却：なし
    //│
    //○先頭を抽出
    argData = QUEUE.front();
    //│
    //○先頭を削除
    QUEUE.pop();
    //│
    //▼返却：あり
     return true;
  } /* popQueue() */

//========================================================
// Ｇ．公開機能
//========================================================
  //─────────────────
  // 初期化処理
  //─────────────────
  void START() {
    //┬
    //○１．サービス資源を生成
    ADP_SRV = new WebSocketsServer(SRV_PORT);
    //│
    //○２．接続管理TBLを作成
    ssTBL = new T_SS_SLOT[SS_SLOTS];
    //│
    //○３．接続管理スロットを静的アタッチ
    ssTBL[0].Base.used = true   ; // 使用中
    //│
    //○４．ルーティングを登録
    ADP_SRV->onEvent(webSocketEvent);
    //│
    //○５．サービスを開始
    ADP_SRV->begin();
    //│
    //○６．アダプタを有効化
    ENABLED = true; 
    //│
    //○７．起動ログを表示（正常終了）
    Serial.println(String("　[OK] WebSocket -> port ") + String(SRV_PORT));
    //┴
  } /* START() */

  //─────────────────
  // ハンドラ入口（ポーリング入口）
  //─────────────────
  void HANDLE(){
    //┬
    //○起動チェック
    if (!ENABLED) return; // 初期化済み
    //│＼（このアダプタが無効の場合）
    //│ ▼終了：早期リターン
    //│
    //●WebSocketサーバの処理を進める
    ADP_SRV->loop();
    //│
    //◎┐ルーティングを指示
    myQueue popDat;
    while (popQueue(popDat)) {
      //│＼（キューが空の場合）
      //│ ▼BREAK：ルーティングを終了
      //│
      //○接続管理スロットを動的アタッチ
      ssTBL[0].connNum = popDat.connNum; // クライアント番号
      ssTBL[0].connRX  = popDat.connRX ; // 受信バッファ
      //│
      //●対象スロットを宣言
      F0_SETUP(ROUTE_ID, 0);
      //│
      //●MMPコマンドへルーティング
      routeMMP(ssTBL[0]);
      //┴
    } /* END-while */
    //┴
  } /* HANDLE() */

} /* namespace adpWSOC */