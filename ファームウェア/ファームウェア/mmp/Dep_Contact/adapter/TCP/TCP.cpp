// filename : Dep_Contact/adapter/TCP/TCP.cpp
//========================================================
// 接客部門／担当(通信アダプタ)：TCP(ベース)
//--------------------------------------------------------
//・通信タイプ： 複数常時接続・非同期受信
//・接続識別子： WiFiClient （TCP接続の実体）
//--------------------------------------------------------
// Ver 1.4.0 (2026/10/08)
//========================================================

class AD_TCP:public AD_API_TSQ<WiFiClient>{
private:
//========================================================
//§基本情報
//========================================================
  int         MY_PORT = 8081   ; // ポート番号
//──────────────────
//➡ブリッジ
//・クライアントを利用
#if MODE == MODE_BRIDGE
//------------------------------------
  WiFiClient  MY_NET           ; // クライアント(実体)
//──────────────────
//➡ブリッジ以外：サーバ
//・サーバを利用
#else
//------------------------------------
  WiFiServer* MY_NET  = nullptr; // サーバ(ポインタ)
//------------------------------------
#endif //➡ブリッジ｜➡ブリッジ以外
//──────────────────

//========================================================
//§接続管理
//========================================================
  //───────────────────────────
  // 接続元の接続状況を確認
  //------------------------------------------------------
  //【戻り値】接続状況
  // true ：接続中
  // false：未接続
  //───────────────────────────
  bool ENABLED_CONN(
    WiFiClient argConn, // 接続識別子
    bool argLog         // ログ出力指示
  ){
    bool ret = argConn.connected();
    if (!ret && argLog) Log::prtln("[ERROR] TCPが未接続です。");
    return ret;
  } /* ENABLED_CONN() */

  //─────────────────
  // 初期化
  //----------------------------------
  // 引数：(参照)接続管理スロット
  //─────────────────
  void SLOT_INI(T_SLOT& argSlot){
    argSlot.used = false;
    if (argSlot.CONN) argSlot.CONN.stop();
  } /* SLOT_INI() */

  //─────────────────
  // スロット内容をセット
  //─────────────────
  void SLOT_INI_SET(
    int              argSID , //
    const WiFiClient argConn  //
  ) {
    //┬
    //●スロットを初期化
    //●スロット内容をセット
    //○スロット内容をセット
    SLOT_INI(TBL[argSID]);
    SLOT_SET(argSID, argConn);
    TBL[argSID].CONN.setNoDelay(true); // TCPパケット遅延制御
    //┴
  } /* SLOT_INI_SET() */

//========================================================
//§受信処理（FreeRTOS用）
//========================================================
  //───────────────────────────
  // 受信処理の定義
  //───────────────────────────
  void ON_RECIVE() override final {
  //┬
  //○┐【前処理】
    //●新接続のスロットを作成
    SLOT_CREATE();
    //┴
  //│
  //○┐【主処理】
    //◎┐スロットを走査
    for (int qSID = 0; qSID < SLOTs; qSID++) {
      //│＼（すべて走査し終えた場合）
      //│ ▼完了：走査を終了
      //│
      //○┐【前処理（走査単位）】
        //○使用状況を確認
        if (!TBL[qSID].used) continue;
        //│＼（[未使用]の場合）
        //│ ▽次へ：次のスロットの走査へ進む
        //│
        //●接続元の接続状況を確認
        if (!ENABLED_CONN(TBL[qSID].CONN, false)){SLOT_INI(TBL[qSID]); continue;}
        //│＼（接続が切れている場合）
        //│ ●スロットを初期化する
        //│ ▽次へ：次のスロットの走査へ進む
        //│
        //○タイムスタンプを更新
        TBL[qSID].timeStamp = millis();
        //┴
      //│
      //○┐キュー情報を用意
        //●フレームを求める
        String qFrame = adpFnStream::GET_FRAME(TBL[qSID].CONN);
        if (qFrame == "") continue;
        //│＼（受信データがない場合）
        //│ ▽次へ：次のスロットの走査へ進む
        //┴
      //│
      //●キューを登録
      pushQueue(TBL[qSID].CONN, qFrame, qSID);
      //┴
    } //～for
    //┴
  //│
  //○┐【後処理】
  //┴┴
  } /* ON_RECIVE() */

//========================================================
//§モード別実装のインクルード
//========================================================
#if MODE == MODE_BRIDGE
  // 関数：SLOT_CREATE(),CONSTRACT(),SEND_REQUEST()
  #include "TCP_Bridge.cpp"
#else
  // 関数：SLOT_CREATE(),CONSTRACT(),SEND_REQUEST()
  #include "TCP_MainSub.cpp"
#endif

//========================================================
//§公開機能
//========================================================
public:
  //━━━━━━━━━━━━━━━━━━━━━━━━━━━
  // コンストラクタ
  //━━━━━━━━━━━━━━━━━━━━━━━━━━━
  AD_TCP(MmpContext& argCtx):
  AD_API_TSQ<WiFiClient>(argCtx, AID::TCP){
  //┬
  //○┐【前処理】
    //●初期化の健全性を確認する
    if (SETUP()) return;
    //│＼（問題がある場合）
    //│ ▼終了：早期リターンする
    //┴
  //│
  //○┐【主処理】
    //●モード別コンストラクタを実施する
    String retMsg = CONSTRACT();
    //┴
  //│
  //○┐【後処理】
    //●起動ログMSGを表示する
    Log::prtln(retMsg);
  //┴┴
  } /* constractor AD_TCP() */

}; /* class AD_TCP */