// filename : adpSer.cpp
//========================================================
// 通信アダプタ：シリアル
//--------------------------------------------------------
// 2026/08/21 : 大幅にリファクタリング
//========================================================
#pragma once
//┬
//■┐インクルード
  //■Arduinoシステム
  //│
  //■ＭＭＰシステム
  #include "adp.h"  // 通信アダプタ共通へ公開
  //┴
//┴

//########################################################
//# 専用名の前空間
//########################################################
namespace adpSerial {
//========================================================
// Ａ．基本情報
//========================================================
  //─────────────────
  // 公開情報
  //─────────────────
  const int  ROUTE_ID = ROUTE_ID_SERIAL; // シリアル
  const int  SS_SLOTS = 2              ; // 固定スロット(物理ポート毎に1個)
        bool ENABLED  = false          ; // 有効性：{有効：true|無効：false}

  //─────────────────
  // 使用するサービス
  //─────────────────
  // 標準のStream型のシリアルを使用
  // ・Serial
  // ・Serial1

  //─────────────────
  // 接続スロット
  //─────────────────
  struct T_SS_SLOT : SS_SLOT_TYPE{ // ※共通テンプレートから派生
      Stream*       conn  = nullptr; // アクセス資源(参照)
  };
  static T_SS_SLOT* ssTBL = nullptr; // 事前予約

//========================================================
// Ｂ．接続管理
//========================================================
  //─────────────────
  // 初期化
  //----------------------------------
  // ➡【該当処理なし】※固定スロット
  //─────────────────
  void SS_INI_SLOT(T_SS_SLOT& argSlot){}

  //─────────────────
  // 空きSID取得
  //----------------------------------
  // ➡【該当処理なし】※固定スロット
  //─────────────────
  int SS_GET_FREE_ID(){}

  //─────────────────
  // 登録
  //─────────────────
  void SS_ATTACH_SLOT(){
    //┬
    //○スロットに[USB-CDC]接続を登録
    ssTBL[0].used   = true     ; // 使用中
    ssTBL[0].conn   = &Serial  ; // 参照先を登録
    //│
    //○スロットに[UART1]接続を登録
    ssTBL[1].used   = true     ; // 使用中
    ssTBL[1].conn   = &Serial1 ; // 参照先を登録
    //┴
  } /* SS_ATTACH_SLOT() */

//========================================================
// Ｃ．レスポンス
//========================================================
  //─────────────────
  // スロットの受付資源に送信
  //─────────────────
  void SEND_CONN(
    T_SS_SLOT&    argSS, // 送信先
    const String& argMSG // 送信メッセージ
  ){
    //┬
    //●ログ出力
    if (ctx.sysLog >= 0) { LOG_PRINT(argMSG); return; }
    //│
    //○メッセージをレスポンス
    argSS.conn->print(argMSG);
    //┴
  } /* SEND_CONN() */

//========================================================
// Ｄ．プロセス部品
//--------------------------------------------------------
// handle()で明示的に呼び出す
//========================================================
  //─────────────────
  // １．接続状態を確認
  //----------------------------------
  // ➡【該当処理なし】
  //─────────────────
  bool P1_CONNECT(T_SS_SLOT& argSS){return false;}

  //─────────────────
  // ２．ストリーム受信
  //----------------------------------
  // 戻り値：受信継続の要否（論理値）
  // ・true ：受信継続が「不要」
  // ・false：受信継続が「必要」
  //----------------------------------
  //【データ受信方式】
  // ・取得対象：デバイス(参照) conn->read()
  //─────────────────
  bool P2_STREAM(T_SS_SLOT&  argSS){
    //┬
    //○1.受信データを受信バッファに加える
    argSS.rx += (char)argSS.conn->read();
    //│
    //○2.オーバーフロー発生を確認
    if (argSS.rx.length() > SS_RX_SIZE) {
    //│ ＼（発生した場合）
        //○オーバーフロー中へ移行
        //○受信バッファをクリア
        //▼RETURN:受信継続が「不要」
        argSS.isOverflow = true;
        argSS.rx         = "";
        return true;
    } /* END-if */
    //│
    //○3.取り込み状態を確認
    if (!argSS.rx.endsWith("!")) return false;
    //│ ＼（終端に達していない場合）
    //│  ▼RETURN:受信継続が「必要」
    //│
    //○4.オーバーフロー中を確認
    if (argSS.isOverflow) {
    //│ ＼（オーバーフロー中の場合）
        //○オーバーフロー中を解除
        //○受信バッファをクリア
        //●エラーコードをレスポンス
        //▼RETURN:受信継続が「不要」
        argSS.isOverflow = false;
        argSS.rx = "";
        SEND_CONN(argSS, "#DFL!");
        return true;
    } /* END-if */
    //│
    //○┐5.フレームを作成
      //○受信バッファの内容をコンテクスト(フレーム)に移動
      ctx.strFrame = argSS.rx;
      argSS.rx = "";
      //│
      //●受信バッファをURI形式に変換
      P2_FORMAT_URI(ctx.strFrame);
      //┴
    //│
    //▼RETURN:受信継続が「不要」
    return true;
    //┴
  } /* P2_STREAM() */

  //─────────────────
  // ２．フレームを取得
  //----------------------------------
  // 戻り値：フレーム作成状況（論理値）
  // ・true ：フレームが「未完成」
  // ・false：フレームが「完成」
  //----------------------------------
  //【データ受信方式】
  // ・取得単位：ストリーム
  // ・継続判定：デバイス(参照) conn->available() 
  //─────────────────
  bool P2_MAKE_FRAME(T_SS_SLOT&  argSS){
    //┬
    //◎┐受信データからフレームを作成
    while (argSS.conn->available()){if (P2_STREAM(argSS)) break;}
      //│＼（未取り込みデータが空の場合）
      //│ ▼取り込みを終了
      //│
      //●受信バッファに蓄える
      //│＼（受信継続が「不要」な場合）
      //│ ▼取り込みを終了
      //┴
    //│
    //▼RETURN:フレームの作成状況
    return (ctx.strFrame == "" ? true : false);
    //┴
  } /* P2_MAKE_FRAME() */

  //─────────────────
  // ３．基本情報を取得（MMP本体のみ）
  //----------------------------------
  //【詳細】
  // フレーム書式    ：{コマンドパス}!
  //─────────────────
  void P3_MAKE_INFO(){
    //┬
    //〇フレームの内容をもとに認証CD・コマンドパスにセット
    P3_SET_ACD_CPATH();
    //┴
  } /* P3_MAKE_INFO() */

  //─────────────────
  // ４．認証を実施（MMP本体のみ）
  //----------------------------------
  //【詳細】
  // 常時接続のため、認証は行わない
  //----------------------------------
  // 戻り値：論理値
  // ・false： 処理の継続可能
  // ・true ： 処理の継続不可
  //─────────────────
  bool P4_AUTH(T_SS_SLOT&  argSS){
    //┬
    //○認証処理をおこなう
    String strRes = P4_CHECK_AUTH();
    if (strRes != "") {SEND_CONN(argSS, strRes); return true;}
    //│ ＼（レスポンスメッセージがある場合）
        //▼RETURN:処理の継続不可
    //│
    //▼RETURN:処理の継続可能
    return false;
    //┴
  } /* P4_AUTH() */

//========================================================
// Ｅ．ルーティング処理（プロセス）
//--------------------------------------------------------
// handle()で明示的に呼び出す
//========================================================
  //─────────────────
  // ルート１：ＭＭＰコマンド
  //----------------------------------
  // 引数：
  // (参)接続管理スロット
  //─────────────────
  void routeMMP(T_SS_SLOT& argSS){
    //┬
    //○１．接続状態を確認
    if (P1_CONNECT(argSS)) return;
    //│ ＼（接続状態が「不良」の場合）
        //▼RETURN：早期リターン
    //│
    //●２．フレームを取得
    if (P2_MAKE_FRAME(argSS)) return;
    //│ ＼（フレームが「未完成」の場合）
        //▼RETURN：早期リターン
    //│
#if defined(MMP_TYPE_MAIN) // --┨ＭＭＰ本体┠----┐
    //○３．基本情報を取得（MMP本体のみ）
    P3_MAKE_INFO();
    //│
    //○４．ユーザ認証を実施（MMP本体のみ）
    if (P4_AUTH(argSS)) return;
    //│ ＼（処理続行の判定が「不許可」の場合）
        //▼RETURN：早期リターン
#endif // ----------------------------------------┘
    //│
    //●５．MMPコマンドを実行
    String resMMP = P5_RUN();
    //│
    //●６．実行結果をレスポンス
    SEND_CONN(argSS, resMMP);
    //┴
  } /* routeMMP() */

//========================================================
// Ｆ．初期化・ポーリング用ハンドル
//========================================================
  //━━━━━━━━━━━━━━━━━
  // 初期化処理
  //----------------------------------
  // 実行元：iniSerial.h - InitSerial()
  //━━━━━━━━━━━━━━━━━
  void start() {
    //┬
    //○１．前準備の完了状態を確認
    if (ssTBL) {
    //│ ＼（接続管理TBLが存在する場合）
        //○エラーメッセージを表示
        //○無効化
        //▼異常終了
        Serial.println("　　Serial   : シリアル通信の開始に失敗 ");
        ENABLED = false; // 無効
        return;
    } /* END-if */
    //│
    //○２．対象の通信経路を宣言
    ctx.routeID = ROUTE_ID; // コンテクストにルートIDをセット
    //│
    //○３．サーバ資源生成
    // ➡【該当処理なし】※セットアップ処理で事前に初期化済み
    //│
    //○４．接続管理TBLを作成
    ssTBL = new T_SS_SLOT[SS_SLOTS];
    SS_ATTACH_SLOT(); // ※固定スロットを事前登録
    //│
    //○５．ルーティング登録
    // ➡【該当処理なし】※handle()で明示的にルーティング
    //│
    //○６．サーバ開始
    // ➡【該当処理なし】※ネットワーク系が対象
    //│
    //○┐７．成功終了
      //○成功メッセージ
      //○有効化
      Serial.println(String("　Serial     : OK"));
      ENABLED = true; // 有効
      //┴
    //┴
  } /* start() */

  //━━━━━━━━━━━━━━━━━
  // ハンドラ入口（ポーリング入口）
  //━━━━━━━━━━━━━━━━━
  void handle(){
    //┬
    //○１．起動チェック
    if (!ENABLED) return; // 初期化済み
    //│ ＼（このアダプタが無効の場合）
    //│  ▼RETURN：早期リターン
    //│
    //○２．新規接続のスロットを登録
    // ➡【該当処理なし】※固定スロット
    //│
    //◎┐３．ルーティング処理
    for (int slotID = 0; slotID < SS_SLOTS; slotID++) {
      //│＼（最終うスロットに達した場合）
      //│ ▼ルーティングを終了
      //│
      //●コンテクストをセットアップ
      //●MMPコマンドへルーティング
      SETUP_CTX(ROUTE_ID, slotID);
      routeMMP(ssTBL[slotID]);
      //┴
      } /* END-for */
    //┴
  } /* handle() */
} /* namespace adpSerial */