// filename : Dep_Connect/adapter/UART_TURBO.cpp
//========================================================
// 接続部門／担当：UART(高速型)
//--------------------------------------------------------
// Ver 1.4.0 (2026/09/27)
//========================================================

//━━━━━━━━━━━━━━━━━━━━━━━━━━━━
// クラス【基本型】
//━━━━━━━━━━━━━━━━━━━━━━━━━━━━
class  AD_UART :
public AD_API
{
private:
//========================================================
//§接続管理
//========================================================
  //───────────────────────────
  // 基本情報
  //───────────────────────────
  Stream* CONN = &Serial; // USB(CDC)だけをセット

//========================================================
//§返信処理
//========================================================
  //───────────────────────────
  // 接続元にMSGをレスポンスする
  //───────────────────────────
  void SEND_CONN(Stream* argConn) {
    //┬
    //○クライアントにレスポンス
    //●ログ出力
    argConn->print(ctx.base.Msg);
    adpFnBase::SHOW_LOG();
    //┴
  } /* SEND_CONN() */

//========================================================
//§ハンドルの事前処理と進行判定
//========================================================
//──────────────────
//➡ブリッジ
//・転送処理はブリッジ固有の機能
#if (MODE == MODE_BRIDGE)
//------------------------------------
  //───────────────────────────
  // ブリッジ用：マスタ
  //------------------------------------------------------
  //【戻り値】進行判定
  // true ：進行NG
  // false：進行OK
  //───────────────────────────
  bool SETUP_BRIDGE() override final {
  //┬
  //○┐【前処理】
    //┴
  //│
  //○┐【主処理】
    //●前処理(マスタ)を実施...進行判定を得る
    bool retGo = modeBridge::MASTER(
      CONN,                                  // 単一スロット
      [this](Stream* conn){SEND_CONN(conn);} // 返信処理(関数をラムダ式で包む)
    );
    //┴
  //│
  //○┐【後処理】
    //▼返却：正常終了(進行判定)
    return retGo;
  //┴
  } /* SETUP_BRIDGE() */
//------------------------------------
#endif //➡ブリッジ
//──────────────────

//========================================================
//§公開機能
//========================================================
public:
  //━━━━━━━━━━━━━━━━━━━━━━━━━━━
  // コンストラクタ【基本型】
  //━━━━━━━━━━━━━━━━━━━━━━━━━━━
  AD_UART(MmpContext& argCtx) :
  AD_API(argCtx, AID::UART)
  {
    //┬
    //○メッセージ表示
    Log::prtln(" [OK] UART Hi-Speed / USB(CDC) only");
    //┴
  } /* constractor AD_UART() */

  //━━━━━━━━━━━━━━━━━━━━━━━━━━━
  // ポーリング用ハンドラ
  //━━━━━━━━━━━━━━━━━━━━━━━━━━━
  void handle() override final {
  //┬
  //○┐【前処理】
    //●ハンドル前処理(一般)
    if (SETUP_NORMAL()) return;
    //│＼（異常の場合）
    //│ ▼終了：早期リターンする
//──────────────────
//➡ブリッジ
//・転送処理はブリッジ固有の機能
#if (MODE == MODE_BRIDGE)
//------------------------------------
    //│
    //●ブリッジ用
    if (SETUP_BRIDGE()) return;
      //│＼（異常の場合）
      //│ ▼終了：早期リターン
//------------------------------------
#endif //➡ブリッジ
//──────────────────
    //┴
  //│
  //○┐【主処理】
    //●ストリームを受信
    String retFrame = adpFnStream::GET_FRAME(*(CONN));
    if (retFrame == "") return;
    //│＼（受信データがない場合）
    //│ ▼終了：早期リターンする
    //│
    //●フレームに従いコンテキストを初期化する
    adpFnBase::SETUP_CTX(MY_AID, retFrame);
    //│
//──────────────────
//➡メイン
//・モード別の主処理
#if   (MODE == MODE_MAIN)
//------------------------------------
    //●コマンドを実行
    //●実行結果をレスポンス
    modeMain::RUN();
    SEND_CONN(CONN);
    //┴
//──────────────────
//➡サブ
//・モード別の主処理
#elif (MODE == MODE_SUB)
//------------------------------------
    //●コマンドを実行
    //●実行結果をレスポンス
    modeSub::RUN();
    SEND_CONN(CONN);
    //┴
//──────────────────
//➡ブリッジ
//・モード別の主処理
#elif (MODE == MODE_BRIDGE)
//------------------------------------
    //●ブリッジ処理を実行
    modeBridge::RUN(0, retFrame);
    if (ctx.base.Msg != "") {SEND_CONN(CONN); return;}
    //│＼（[内部コマンド応答済][エラーあり]の場合）
    //│ ○クライアントにレスポンス
    //│ ▼終了：早期リターンする
    //│
    //○進捗状況を[依頼中]にセット
    //▼終了：早期リターンする ※1件ずつ処理
    Log::Outln("1.待機中→依頼中");
    ctx.trans.Stat = BSTAT::REQ;
    return;
//------------------------------------
#endif //➡マスタ｜➡サブ｜➡ブリッジ
//──────────────────
  //│
  //○┐【後処理】
  //┴┴
  } /* handle() */

}; /* class AD_UART */