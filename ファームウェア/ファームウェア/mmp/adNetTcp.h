// filename : adNetTcp.h
//========================================================
// 通信アダプタ：ＴＣＰブリッジ
//--------------------------------------------------------
// ・TCP Bridgeサーバの起動
// ・TCP Bridgeのポーリング処理
//   受信→認証開始→認証検証→コマンド実行→結果返却
//--------------------------------------------------------
// Ver 1.1.0 (2026/08/05) α版 
// ・ファイル名を変更
// ・全体的にリファクタリング
// ・各種リソース(処理/構造体など)を共通側に定義
// ・ユーザIDは共通関数で求めるよう変更
// ・フレームが完成したら後続処理するよう変更
// ・受信データの容量超過に対応
//========================================================
#pragma once
#include "ad.h"  // 通信アダプタ共通

//━━━━━━━━━━━━━━━━━
// グローバル資源(宣言)
//━━━━━━━━━━━━━━━━━
  //─────────────────
  // 統一入口：fnPerser.hで定義
  //─────────────────
  extern String MMP_REQUEST(const String& cmdPath, int usrID);

//─────────────────
// サーバ情報
//----------------------------------
// 値セット:adNet.h - InitNet_Json2()
//─────────────────
struct typeServer {
  int      maxClients   = 0     ; // 最大接続数
  bool     writeLock    = false ; // 書込ロック有無
  uint32_t writeLockMs  = 0     ; // 書込ロック時間[単位:ms]
};
typeServer g_SRV_TCP;


//========================================================
// メイン処理
//--------------------------------------------------------
//【マルチ接続・持続型】
// TCPブリッジの各TCP接続を1ユーザとして扱う。
// 接続状態は継続的に保持する。
// タイムアウトや再接続があるため、ユーザー認証を行う。
//--------------------------------------------------------
//・フレーム書式   ：認証コード/コマンドパス!
//・状態管理       ：TCP接続ごとに1スロット
//・認証機能
//　├ 接続スロット：あり
//　└ 認証コード  ：あり
//========================================================
namespace {
//━━━━━━━━━━━━━━━━━
// ネームスペース資源(宣言)
//━━━━━━━━━━━━━━━━━
  //─────────────────
  // 基本情報
  //─────────────────
  static const int ROUTE_ID    = ROUTE_ID_TCP ; // 通信経路のID
  WiFiServer*  ns_ACCEPTOR     = nullptr      ; // ユーザ受付資源
  static SLOT_TCP* ssTBL       = nullptr      ; // 接続管理TBL
  static TYPE_AUTH_SLOT AUTH_TBL[SS_SLOTS]    ; // 認証情報TBL

//━━━━━━━━━━━━━━━━━
// 接続管理
//━━━━━━━━━━━━━━━━━
  //─────────────────
  // スロットを開放
  //----------------------------------
  // 当該接続は管理から外れる
  //─────────────────
  // 戻り値：なし
  //─────────────────
  void DETACH_SS_SLOT_SID(SLOT_TCP& argSlot){
    if (argSlot.conn) argSlot.conn .stop(); // 接続を切断
    INIT_SLOT_TCP(argSlot);
  } /* DETACH_SS_SLOT_SID() */

  //─────────────────
  // スロットを開放(キー：認証コード)
  //----------------------------------
  // 当該接続は管理から外れる
  //─────────────────
  // 戻り値：なし
  //─────────────────
  void DETACH_SS_SLOT_ACD(const String& argCD){
  //┬
  //◎┐先頭から走査
  for (int id = 0 ; id < g_SRV_TCP.maxClients ; id++) {
    //○次データの捜査を開始
    // ＼（全スロットを走査し終えた場合）
      //▼ループ処理を中断
    //│
    //◇┐スロットと照合
    if ( ssTBL[id].authCD == argCD ) DETACH_SS_SLOT_SID(ssTBL[id]);
      //├→（認証コードが一致する場合）
        //●この接続を管理から外す
        //┴
      //└┐
        //┴
  } /* END-for */
    //┴
  //┴
  } /* DETACH_SS_SLOT_ACD() */

  //─────────────────
  // 空きスロットを照会
  //----------------------------------
  // 該当条件：未使用
  //----------------------------------
  // 戻り値：
  // ・0,1,2...：空きスロットのID
  // ・-1：空きスロットが無い
  //─────────────────
  int GET_FREE_SID() {
  //┬
  //◎┐先頭から走査
  for (int id = 0 ; id < g_SRV_TCP.maxClients ; id++) {
    //○次データの捜査を開始
    // ＼（全スロットを走査し終えた場合）
      //▼ループ処理を中断
    //│
    //◇┐空きスロットを返す
    if ( !ssTBL[id].used ) return id;
      //├→（未使用の場合）
        //▼当該スロットIDを返す
        //┴
      //└┐
        //┴
  } /* END-for */
    //┴
  //│
  //▼エラーコードを返す(空きスロットがない)
  return -1;
  //┴
  } /* GET_FREE_SID() */

  //─────────────────
  // 古いスロットを照会
  //----------------------------------
  // 該当条件：使用中 かつ タイムアウト
  //----------------------------------
  // 戻り値：
  // ・0,1,2...：タイムアウトしたスロットID
  // ・-1：タイムアウトしたスロットが無い
  //─────────────────
  int GET_OLD_SID() {
  //┬
  //◎┐先頭から走査
  for (int id = 0 ; id < g_SRV_TCP.maxClients ; id++) {
    //○次データの捜査を開始
    // ＼（全スロットを走査し終えた場合）
      //▼ループ処理を中断
    //│
    //◇┐空きスロットを返す
    if ( ssTBL[id].used &&
         millis() - ssTBL[id].lastActive > SS_TIME_LIMIT) return id;
      //├→（使用中でタイムアウト の場合）
        //▼当該スロットIDを返す
      //└┐
        //┴
    //┴
  } /* END-for */
  //│
  //▼エラーコードを返す(空きスロットがない)
  return -1;
  //┴
  } /* GET_OLD_SID() */

  //─────────────────
  // 接続管理TBLを作る
  //----------------------------------
  // 戻り値：なし
  //─────────────────
  void CREATE_SS_TBL(){
  //┬
  //○領域サイズをセット
  int maxCount = g_SRV_TCP.maxClients;
  //│
  //○領域を確保
   ssTBL = new SLOT_TCP[maxCount];
  //│
  //◎┐TBL全体を初期化
  for (int id = 0; id < maxCount ; id++) INIT_SLOT_TCP(ssTBL[id]);
    //●このスロットを初期化
    //┴
  //┴
  } /* CREATE_SS_TBL() */

  //─────────────────
  // 接続を接続スロットに割り当てる
  //----------------------------------
  // 戻り値：なし
  //----------------------------------
  // WiFiServerが受け付けた新たなTCP接続を
  // 自前の接続管理下に置く
  // ポーリング毎に実行される
  //─────────────────
  void ATTACH_SS_SLOT(){
  //┬
  //◎┐未管理のTCP接続をMMP管理対象へ登録する
  while (true) {
    //○新規のTCP接続を取得
    //  ※受付待ちキュー内のTCP接続情報を取得
    //  ※取得後、受付待ち状態から管理処理へ移行
    WiFiClient newConn = ns_ACCEPTOR->available();
    if (!newConn) break;
    // ＼（取得に失敗(待ち接続なし)の場合）
      //▼ループ処理を中断
    //│
    //●空きスロットを探す
    int id = GET_FREE_SID();
    if (id < 0) {
    // ＼（空きスロットがない）
      //●古いスロットを探す
      id = GET_OLD_SID();
      if (id < 0) {
      // ＼（古いスロットがない）
        //▼カレント処理をスキップ
        newConn.stop();
        continue;
      //│
      //●古いスロットを開放
      DETACH_SS_SLOT_SID(ssTBL[id]);
      } /* END-if */
      //┴
    } /* END-if */
    //│
    //●スロットを初期化
    INIT_SLOT_TCP(ssTBL[id]);
    //│
    //○スロットに新規接続を登録
    ssTBL[id].used       = true     ; // 管理スロットを使用中へ変更
    ssTBL[id].conn       = newConn  ; // 新規のTCP接続を管理スロットへ登録
    ssTBL[id].conn .setNoDelay(true); // TCPパケット遅延制御を設定
    ssTBL[id].lastActive = millis() ; // 最終活動時刻を初期設定
    //┴
  } // while
  //┴
  } /* ATTACH_SS_SLOT() */

  //─────────────────
  // 接続認証を実施
  //----------------------------------
  // 戻り値：認証結果
  //・成功：false
  //・失敗：true
  //----------------------------------
  // 接続認証は失敗しない仕様とした。
  // 認証コードが不一致の場合でも、
  // 指定の認証コードを採用し救済した。
  // ※救済しない仕様へ変更する際、分岐処理で早期リターン(true)させる。
  //─────────────────
  bool SS_AUTH(
    SLOT_TCP& argSS  , // 接続管理スロット
    String    argACD   // フレームから取得した認証コード
  ){
  //┬
  //○認証コードを比較
  if (argSS.authCD != argACD) {
  // ＼（異なる場合）※再接続の条件
    //●古い(同じ認証コード)接続管理スロットを開放
    DETACH_SS_SLOT_ACD(argACD);
    //│
    //○認証コードを上書き
    argSS.authCD = argACD;
    //┴
  } /* END-if */
  //│
  //●最終更新時刻を更新
  argSS.lastActive = millis();
  //│
  //▼RETURN:合格
  return false;
  //┴
  } /* SS_AUTH() */

  //─────────────────
  // データ送信
  //─────────────────
  void SEND_CONN(
    SLOT_TCP&     argSS  , // 送信先
    const String& argMSG   // 送信メッセージ
  ){
  //┬
  //○メッセージをレスポンス
  argSS.conn->print(argMSG);
  //┴
  } /* SEND_CONN() */



//━━━━━━━━━━━━━━━━━
// ルート別の処理
//----------------------------------
// 実行元：mmp.ino - loop()
//----------------------------------
// ルーティング先は１つ(MMPコマンド)
// ロジックで明示的に呼び出す..handle()を参照
//━━━━━━━━━━━━━━━━━
  //─────────────────
  // ルート０：ホスト直下
  //─────────────────
  //　➡【該当処理なし】

  //─────────────────
  // ルート１：ＭＭＰコマンド
  //----------------------------------
  // 引数：
  // (参)接続管理スロット
  //─────────────────
  void routeMMP(SLOT_TCP& argSS){
  //┬
  //○┐０．前処理
    //○┐0-1.処理継続可否を確認
      //○0-1-1.物理状態を確認
      if (!argSS.conn.connected()) return; // TCP接続状態
      // ＼（通信断の場合）
        //▼ルーティング処理を中断
      //│
      //○0-1-2.論理状態(接続管理スロット)を確認
      if (!argSS.used) return;
      // ＼（未使用スロットの場合）
        // ▼ルーティング処理を中断
      //┴
    //│
    //○0-2.準備完了フラグを用意
    bool isReady = false;
    //┴
  //│
  //◎┐１．受信待ちデータの取り込み
  while (argSS.conn.available()) {
    //○1-1.取り込みの継続を確認
    // ＼（受信待ちデータがない場合）
      //▼取り込みを終了
    //│
    //○1-2.受信データを受信バッファに加える
    char ch = (char)argSS.conn.read(); // ※バイト単位
    if (argSS.rx.length() < SS_RX_SIZE) {argSS.rx += ch;}
    else {
    // ＼（受信バッファが許容サイズを超過した場合）
      //○データ容量超過状態へ移行
      //○受信バッファの内容を破棄
      //▼ルーティング処理を中断
      //  ※残りの受信待ちデータは次回のルーティングで処理される
      argSS.isOverflow = true;
      argSS.rx         = "";
      return;
    } /*【1-2.受信データを受信バッファに加える】*/
    //│
    //◇┐1-3.フレームの完成を確認
    if (ch == '!') {
      //├→（コマンド終端を検出した場合）
        //○オーバーフローを確認
        if (argSS.isOverflow) {
        // ＼（オーバーフロー中の場合）
          //○データ容量超過状態を解除
          //○受信バッファをクリア
          //●エラーコードをレスポンス
          //▼ルーティング処理を中断
          argSS.isOverflow = false;
          argSS.rx         = ""   ;
          SEND_CONN(argSS, "#DFL!");
          return;
        } /*【1-3-1.オーバーフローを確認】*/
        //│
        //○準備完了フラグを[ON]
        //▼取り込みを終了
        isReady = true;
        break;
      //┴
    } /*【1-3.フレームの完成を確認】*/
    //┴
  } /*【１．受信待ちデータの取り込み】*/
  //│
  //○２．後続処理の継続を判断
  if (!isReady) return;
  // ＼（準備が未完了の場合）
    //▼ルーティング処理を中断
  //│
  //○┐３．事前準備
    //●3-1.受信バッファをURI形式に変換
    FormatURI(argSS.rx);
    //│
    //○┐3-2.事前データを用意
      //○3-2-1.認証コードを取得
      //○3-2-2.コマンドパスを取得
      String authCD  = GetToken1(argSS.rx);
      String cmdPath = GetToken2(argSS.rx);
      //┴
    //│
    //○3-3.受信バッファを破棄
    argSS.rx = "";
    //┴
  //│
  //○┐４．認証を実施
    //○4-1.認証開始要求を処理
    if (authCD == "_START_!") {
      //├→（例外的に認証コードの中身が「接続開始コマンド」の文字列の場合）
        //●4-1-1.この接続を認証管理に加える
        String newAuthCD = AUTH_START(AUTH_TBL);
        if(newAuthCD == ""){
        // ＼（管理開始に失敗した場合）
          //●エラーコードをレスポンス
          //▼ルーティング処理を中断
          SEND_CONN(argSS, "#SS0!"); // 認証開始に失敗
          return;
        } /* END-if*/
        //│
        //○4-1-2.認証コードをスロットに反映
        //●4-1-3.認証コードをレスポンス
        //▼4-1-4.ルーティング処理を中断
        argSS.authCD = newAuthCD;
        SEND_CONN(argSS, newAuthCD); // 認証コード
        return;
      //┴
    } /*【4-1.認証開始要求を処理】*/
    //│
    //○┐4-2.認証の実施
      //●4-2-1.ユーザ認証を実施
      int authID = AUTH_GET_ID(AUTH_TBL, authCD);
      if (authID < 0) {
      // ＼（認証に失敗した場合）
        //●エラーコードをレスポンス
        //▼ルーティング処理を中断
        SEND_CONN(argSS, "#SS1!"); // セッションエラー(ユーザ認証)
        return;
      } /* 4-2-1.ユーザ認証を実施 */
      //│
      //●4-2-2.接続認証を実施
      if (SS_AUTH(argSS, authCD)) {
      // ＼（認証に失敗した場合）
        //●エラーコードをレスポンス
        //▼ルーティング処理を中断
        SEND_CONN(argSS, "#SS2!"); // セッションエラー(接続認証)
        return;
      } /* END-if */
      //┴
    //┴
  //│
  //○┐５．MMPコマンドを実行
    //●対象ユーザを特定
    //●コマンドパーサーへ処理を移譲
    //●実行結果をレスポンス
    int usrID = GET_USER_ID(ROUTE_ID, authID); // ※認証情報から照会
    String mmpResp = MMP_REQUEST(cmdPath, usrID);
    SEND_CONN(argSS, mmpResp);
    //┴
  //┴
  } /* routeMMP() */

//━━━━━━━━━━━━━━━━━
// ルーティング登録
//----------------------------------
// ロジックで明示的に呼び出す..handle()を参照
//━━━━━━━━━━━━━━━━━
//　➡【該当処理なし】

} /* namespace(匿名) */


//========================================================
// ハンドラ関連処理
//--------------------------------------------------------
// start()
// ├ WiFiServer生成
// ├ 空SLOT生成
// └ begin
//--------------------------------------------------------
// handle()
// ├ 新規接続取得
// ├ SLOT割当（新規接続だけが割り当てられる）
// └ route処理
//========================================================
namespace srvTcp {
  //━━━━━━━━━━━━━━━━━
  // 初期化処理
  //----------------------------------
  // 実行元：adNet.h - InitNet_Service()
  //━━━━━━━━━━━━━━━━━
  bool start(uint16_t port){

    // 1) 二重起動防止
    if (ns_ACCEPTOR ) return true      ; // ユーザ受付が準備済みか

    // 2) サーバ資源生成
    ns_ACCEPTOR = new WiFiServer(port) ; // ユーザ受付に資源をセット

    // 3) 接続管理TBLを作成
    CREATE_SS_TBL()                    ; // 領域確保
                                       ; // スロット初期化は handle() で実施

    // 4) ルーティング登録
    //　➡【該当処理なし】

    // 5) サーバ開始
    ns_ACCEPTOR->setNoDelay(true)      ; // TCPの遅延を抑制
    ns_ACCEPTOR->begin()               ; // サーバ起動

    // 6) 正常終了
    return true;
  } /* start() */

  //━━━━━━━━━━━━━━━━━
  // ハンドラ入口（ポーリング入口）
  //----------------------------------
  // 実行元：mmp.ino - loop()
  //━━━━━━━━━━━━━━━━━
  void handle(){

    // 1) 起動チェック
    if (!ns_ACCEPTOR ) return; // サーバの実体化有無を評価

    // 2) {新規接続時｜再接続時}を管理対象に加える
    ATTACH_SS_SLOT();

    // 3) ルーティング処理
    int maxCount = g_SRV_TCP.maxClients; // 経路別の最大ユーザ数
    for (int id = 0; id < maxCount; id++) routeMMP(ssTBL[id]);
  } /* handle() */

} /* namespace srvTcp */
