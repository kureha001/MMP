// filename : adpUART.cpp
//========================================================
// 通信アダプタ：ＵＡＲＴ
//（物理ポートを直接扱う通信）
//--------------------------------------------------------
//【目的】
// リクエストに従い、ＭＭＰコマンドを実行して、
// 結果をレスポンスする。
//--------------------------------------------------------
//【処理機能】
//・UARTポート毎に資源の参照をスロットに割り当てる。
//・ポーリング跨りでストリーム処理するためポート数だけスロットを消費する。
//--------------------------------------------------------
// Ver 1.2.0 (2026/08/25) 
// ・全体のロジックをシンプル化
//========================================================
#pragma once
//┬
//■┐インクルード
  //■Arduinoシステム
  #include <Arduino.h>
  #include <queue>
  #include <mutex>
  //│
  //■ＭＭＰシステム
  #include "adp.h"  // 通信アダプタ共通へ公開
  //┴
//┴

//########################################################
//# 専用名の前空間
//########################################################
namespace adpUART {
//========================================================
// Ａ．基本情報
//========================================================
  //─────────────────
  // ステータス
  //─────────────────
  const String ADP_ID  = "UART"; // アダプタID
  const int    SS_SLOTS = 2    ; // 固定スロット(物理ポート毎に1個)
        bool   ENABLED  = false; // 有効性：{有効：true|無効：false}


    //─────────────────
    // 接続スロット
    //─────────────────
    struct T_SS_SLOT{
      SS_SLOT_TYPE Base              ; // 基本メンバ
      Stream*      conn  = nullptr   ; // アクセス資源(参照)
    };
    static T_SS_SLOT* ssTBL = nullptr; // 事前予約


//========================================================
// Ｂ．レスポンス
//========================================================
  void SEND_CONN(Stream* argConn){
    //┬
    //○メッセージをレスポンス
    if (argConn != nullptr) argConn->print(ctx.resMSG);
    P9_SHOW_LOG();
    //┴
  } /* SEND_CONN() */

//========================================================
// Ｃ．リクエスト・キュー管理
//========================================================
  //─────────────────
  // 基本情報
  //─────────────────
    struct myQueue {
      Stream* conn = nullptr; // アクセス資源(参照)
      String  frame        ; // 受信バッファ
    };
    static std::queue<myQueue> QUEUE      ; // キューバッファ
    static std::mutex          QUEUE_MUTEX; // 別スレッドとの衝突回避用のロック

  //─────────────────
  // キューの取出
  //----------------------------------
  // 引数：
  // ・キュー受取用の変数
  //----------------------------------
  // 戻り値：キューの有無（論理値）
  // ・true ：あり
  // ・false：なし
  //─────────────────
  bool popQueue(myQueue &argData) {
    //┬
    //○別スレッドとの衝突回避用のロック
    std::lock_guard<std::mutex> lock(QUEUE_MUTEX);
    //│
    //○キューの容量を確認
    if (QUEUE.empty()) return false;
    //│＼（通信デバイスが起動していない場合）
    //│ ▼返却：なし
    //│
    //○先頭を抽出
    //○先頭を削除
    //▼返却：あり
    argData = QUEUE.front();
    QUEUE.pop();
     return true;
  } /* popQueue() */

//========================================================
// Ｄ．データ受信
//========================================================
  //─────────────────
  // 別タスクとして機能
  //─────────────────
  void ON_RECIVE(){
    //┬
    //◎┐スロットを走査
    for (int ID = 0; ID < SS_SLOTS; ID++) {
      //│＼（最後のスロットに達した場合）
      //│ ▼完了：走査を終了
      //│
      //○スロットの状態を確認
      if (ssTBL[ID].conn == nullptr) continue;
      //│＼（未使用の場合）
      //│ ▽次へ：次のスロットを走査
      //│
      //●ストリームを受信
      String retFrame = P2_STREAM(*(ssTBL[ID].conn), ssTBL[ID].Base);
      if (retFrame == "") continue;
      //│＼（フレームが未完成の場合）
      //│ ▽次へ：次のスロットを走査
      //│
      //○キューに登録
      std::lock_guard<std::mutex> lock(QUEUE_MUTEX); // 排他ロック
      QUEUE.push({ssTBL[ID].conn, retFrame})       ; // キューを追加(通信資源、フレーム)
      //┴
    } /* END-for */
    //┴
  } /* ON_RECIVE() */

  //─────────────────
  // タスクのハンドルを保持する変数
  //─────────────────
  static TaskHandle_t TaskHandle = NULL;

  //─────────────────
  // FreeRTOSタスクのエントリポイント
  //─────────────────
  void StreamQueue(void *pvParameters) {
    for (;;) {
      ON_RECIVE();                        // コールバック関数を登録
      vTaskDelay(1 / portTICK_PERIOD_MS); // 短いウェイト
    }
  } /* StreamQueue() */

//========================================================
// Ｅ．公開機能
//========================================================
  //━━━━━━━━━━━━━━━━━
  // 初期化処理
  //━━━━━━━━━━━━━━━━━
  void START() {
    //┬
    //○┐サービスを開始
      //│
      //●接続管理TBLを作成
      ssTBL = new T_SS_SLOT[SS_SLOTS];
      ssTBL[0].Base.used = true     ; // 使用中
      ssTBL[0].conn      = &Serial  ; // 参照先を登録
      ssTBL[1].Base.used = true     ; // 使用中
      ssTBL[1].conn      = &Serial1 ; // 参照先を登録
      //│
      //○受信タスクをFreeRTOSの別スレッドとして起動（コア0に割り当て）
      xTaskCreatePinnedToCore(
        StreamQueue,    // 実行するタスク関数
        "UART_ADAPTER", // タスク名（デバッグ用）
        4096,           // スタックサイズ（バイト単位）
        NULL,           // パラメータ
        2,              // 優先度
        &TaskHandle,    // タスクハンドル
        0               // 割り当てるコア番号 (0)
      );
      //┴
    //│
    //○アダプタを有効化
    ENABLED = true; 
    Serial.println(String("　[OK] USB/UART  -> #0,#1"));
    //┴
  } /* START() */

  //━━━━━━━━━━━━━━━━━
  // ハンドラ入口（ポーリング入口）
  //━━━━━━━━━━━━━━━━━
  void HANDLE(){
    //┬
    //○起動チェック
    if (!ENABLED) return; // 初期化済み
    //│＼（このアダプタが無効の場合）
    //│ ▼終了：早期リターン
    //│
    //◎┐ルーティングを指示
    myQueue popDat;
    while (popQueue(popDat)) {
      //│＼（キューが空の場合）
      //│ ▼完了：ルーティングを終了
      //│
      //○フレームの状態を確認
      if (popDat.frame.startsWith("#")){SEND_CONN(popDat.conn); continue;}
      //│＼（エラーが発生している場合）
      //│ ●エラーをレスポンス
      //│ ▽次へ：次のキューを走査
      //│
      //●キュー情報をワークにセット
      P0_SETUP_CONTEXT(ADP_ID, popDat.frame);
      //│
#if defined(MMP_TYPE_MAIN) // --┨ＭＭＰ本体┠----┐
      //○リクエストをデータ項目に分解
      P1_SET_ACD_CPATH();
      //│
      //●認証処理を実施
      if (P2_CHECK_AUTH()){SEND_CONN(popDat.conn); continue;}
      //│＼（処理継続が不可の場合）
      //│ ●エラーをレスポンス
      //│ ▽次へ：次のキューを走査
#endif // ----------------------------------------┘
      //│
      //●コマンド実行
      P3_RUN();
      //│
      //●実行結果をレスポンス
      SEND_CONN(popDat.conn);
      //┴
    } /* END-while */
    //┴
  } /* HANDLE() */

} /* namespace adpUART */