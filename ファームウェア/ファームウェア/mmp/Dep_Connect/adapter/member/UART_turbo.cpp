// filename : Dep_Connect/adapter/base/UART_TURBO.cpp
//========================================================
// 接続部門／業務課／担当(標準型)：UART(高速版) 担当
//--------------------------------------------------------
// Ver 1.3.2 (2026/09/15)
// ・新規
//========================================================

//========================================================
// 組織図
//========================================================
//┬
//□┐接続部門
  //□┐業務課
    //□担当
    #include "_index_.h"
//┴┴┴

//########################################################
//# 処理詳細
//########################################################
class AdapterUART : public AdapterBase {
public:
  //━━━━━━━━━━━━━━━━━
  // 抽象基底クラスからコンテクストを継承
  //━━━━━━━━━━━━━━━━━
  using AdapterBase::AdapterBase;

private:
//========================================================
//§基本情報
//========================================================
  //━━━━━━━━━━━━━━━━━
  // 一般情報
  //━━━━━━━━━━━━━━━━━
    const int ADP_ID = ADP_ID_UART;

//========================================================
//§接続管理
//========================================================
  //─────────────────
  // 基本情報
  //─────────────────
  Stream* CONN = &Serial; // USB(CDC)だけをセット

//========================================================
//§返信処理
//========================================================
  //━━━━━━━━━━━━━━━━━
  // クライアントにレスポンス
  //━━━━━━━━━━━━━━━━━
  void SEND_CONN() {
    //┬
    //○クライアントにレスポンス
    //●ログ出力
    CONN->print(ctx.resMSG);
    adpFnBase::SHOW_LOG();
    //┴
  } /* SEND_CONN() */

//############################
//# 転送機能はブリッジのみ
//############################
#if (MODE == MODE_BRIDGE)
//========================================================
//§転送処理
//========================================================
  //━━━━━━━━━━━━━━━━━
  // ポーリングの前処理
  //━━━━━━━━━━━━━━━━━
  bool handle_Begin() override final {
    //┬
    //◇ブリッジマスタとして進行を制御
    switch (ctx.bridge.Stat) {
      case BSTAT::IDLE: return false; // 待機中：進行OK
      case BSTAT::REQ : return true ; // 依頼中：進行NG
      case BSTAT::BUSY: return true ; // 処理中：進行NG
      case BSTAT::DONE:               // 処理済：進行OK
        //●ブリッジ元にレスポンス
        //○進行状況を［待機中］にセット
        //▼終了：早期リターン（進行OK）
        SEND_CONN();
        ctx.bridge.Stat = BSTAT::IDLE;
        return false;
    } /* END-switch */
    return true; // 想定外：進行NG
  } /* handle_Begin() */
#endif
//############################

//========================================================
//§公開機能
//========================================================
public:
  //━━━━━━━━━━━━━━━━━
  // コンストラクタ
  //━━━━━━━━━━━━━━━━━
  AdapterUART(MmpContext& argCtx) : AdapterBase(argCtx) {
    //┬
    //○メッセージ表示
    Log::prtln(" [OK] UART Hi-Speed / USB(CDC) only");
    //┴
  } /* constractor AdapterUART() */

  //━━━━━━━━━━━━━━━━━
  // ポーリング用ハンドラ
  //━━━━━━━━━━━━━━━━━
  void handle() override final {
    //┬
    //●前処理
    if (handle_Begin()) return;
    //│＼（進行NGの場合）
    //│ ▼終了：早期リターン
    //│
    //●ストリームを受信
    String retFrame = adpFnStream::GET_FRAME(*(CONN));
    if (retFrame == "") return;
    //│＼（受信データがない場合）
    //│ ▼終了：早期リターン
    //│
    //●コンテキストを初期化
    adpFnBase::SETUP_CTX(ADP_ID, retFrame);
    //│
//--------------------------
//【メイン】主処理を実行
//--------------------------
#if   (MODE == MODE_MAIN)
    //●コマンドを実行
    //●実行結果をレスポンス
    modeMain::RUN();
    SEND_CONN();
    //┴
//--------------------------
//【サブ】主処理を実行
//--------------------------
#elif (MODE == MODE_SUB)
    //●コマンドを実行
    //●実行結果をレスポンス
    modeSub::RUN();
    SEND_CONN();
    //┴
//--------------------------
//【ブリッジ】マスタ処理
//--------------------------
#elif (MODE == MODE_BRIDGE)
    modeBridge::RUN();
    if (ctx.resMSG == "") ctx.bridge.Stat = BSTAT::REQ;
    else SEND_CONN();
    //◆┐ブリッジ処理を実行
      //├┐（リクエストが[MMPコマンド転送]の場合）
        //○進捗状況を[依頼中]にセット
        //┴
      //└┐（その他：[特殊コマンド実行][システムコマンド実行][エラーあり]）
        //●ブリッジ元にレスポンス
        //┴
    //┴
#endif
//--------------------------
} /* handle() */

}; /* class AdapterUART */