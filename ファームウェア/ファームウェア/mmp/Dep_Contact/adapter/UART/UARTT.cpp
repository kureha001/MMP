// filename : Dep_Contact/adapter/UART/UARTT.cpp
//========================================================
// 接客部門／担当(通信アダプタ)：UART 高速型(ベース)
//--------------------------------------------------------
//・通信タイプ： 基本
//・接続識別子： Stream* （UART接続の参照）
//--------------------------------------------------------
// Ver 1.4.0 (2026/10/08)
//========================================================

class AD_UART:public AD_API<Stream*>{
private:
//========================================================
//§接続管理
//========================================================
  //───────────────────────────
  // 基本情報
  //───────────────────────────
  Stream* CONN = &Serial; // USB(CDC)だけをセット

//========================================================
//§最終処理
//========================================================
  //───────────────────────────
  // 終了処理：接続元に処理結果を送信する
  //───────────────────────────
  void SEND_RESULT(Stream* argConn) override final {
    //┬
    //○接続元に処理結果を送信する
    //●コンテクスト・ログを出力する
    argConn->print(ctx.base.Result);
    adpFnBase::LOG_CTX();
    //┴
  } /* SEND_RESULT() */

//========================================================
//§ モード別実装のインクルード
//========================================================
#if MODE == MODE_BRIDGE
  // 関数：WORKFLOW(), RUN_PROCESS()
  #include "UART_Bridge.cpp"
#endif

//========================================================
//§公開機能
//========================================================
public:
  //━━━━━━━━━━━━━━━━━━━━━━━━━━━
  // コンストラクタ
  //━━━━━━━━━━━━━━━━━━━━━━━━━━━
  AD_UART(MmpContext& argCtx):
  AD_API<Stream*>(argCtx, AID::UART){
    //┬
    //●起動ログMSGを表示する
    Log::prtln(" [OK] UART Hi-Speed / USB(CDC) only");
    //┴
  } /* constractor AD_UART() */

  //━━━━━━━━━━━━━━━━━━━━━━━━━━━
  // ポーリング用ハンドラ
  //━━━━━━━━━━━━━━━━━━━━━━━━━━━
  void handle() override final {
  //┬
  //○┐【前処理】
    //●ハンドル前処理(一般)
    if (SETUP()) return;
    //│＼（進行不可の場合）
    //│ ▼終了：早期リターンする
    //│
  //──────────────────
  //➡ブリッジモード
  #if MODE == MODE_BRIDGE
  //------------------------------------
    //●処理フローを制御する
    if (WORKFLOW()) return;
    //│＼（進行不可の場合）
    //│ ▼終了：早期リターン
  //------------------------------------
  #endif //➡ブリッジ
  //──────────────────
    //┴
  //│
  //○┐【主処理】
    //●フレームを求める
    String retFrame = adpFnStream::GET_FRAME(*(CONN));
    if (retFrame == "") return;
    //│＼（受信データがない場合）
    //│ ▼終了：早期リターンする
    //│
    //●コンテキストを更新する
    adpFnBase::SETUP_CTX(
      MY_AID,   // 通信アダプタID
      0,        // 接続スロットID(ダミー値)
      retFrame  // 求めたフレーム
    );
    //│
    //●主処理を実行する
    bool ret = this->RUN_PROCESS(CONN);
    //┴
  //│
  //○┐【後処理】
  //┴┴
  } /* handle() */

}; /* class AD_UART */