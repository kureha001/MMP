// filename : adSerial.h
//========================================================
// 通信アダプタ：シリアル
//--------------------------------------------------------
// ・シリアル通信のポーリング処理
//   受信→コマンド実行→結果返却
//-------------------------------------------------------- 
//--------------------------------------------------------
// Ver 1.0.1 (2026/08/05) α版 
// ・全体的にリファクタリング
// ・各種リソース(処理/構造体など)を共通側に定義
// ・ユーザIDはスロットから求めるよう変更
// ・フレームが完成したら後続処理するよう変更
// ・接続管理の取り入れ
// ・ルーティングの引数をオブジェクトに変更
//========================================================
#include "ad.h"  // 通信アダプタ共通
#include "mod.h" // 機能モジュール：抽象基底クラス

//━━━━━━━━━━━━━━━━━
// グローバル資源(宣言)
//━━━━━━━━━━━━━━━━━
  //─────────────────
  // 統一入口：fnPerser.hで定義
  //─────────────────
  extern String MMP_REQUEST(const String& cmdPath, int usrID);

  //─────────────────
  // サーバ情報
  //─────────────────
  //　➡【該当処理なし】

//━━━━━━━━━━━━━━━━━
// グローバル資源(宣言)
// ※シリアル通信固有
//━━━━━━━━━━━━━━━━━
  //─────────────────
  // コンテクスト
  //----------------------------------
  // 型定義：mod.h
  // 実　装：mmp.ino
  //─────────────────
  extern MmpContext ctx;

  //━━━━━━━━━━━━━━━━━
  // 通信速度の定義・設定
  //━━━━━━━━━━━━━━━━━
  //─────────────────
  // ボーレートのプリセット
  //─────────────────
  static const int BAUD_PRESETS[8] = {
    921600,57600,38400,19200,9600,4800,2400,300
  };

  //─────────────────
  // ボーレート変更スイッチのGPIO
  //─────────────────
  #define SW_PIN_A 18 // bit-0
  #define SW_PIN_B 14 // bit-1
  #define SW_PIN_C 13 // bit-2

  //─────────────────
  // ボーレート別のRGB-LED点灯色
  //─────────────────
  struct RGB { uint8_t r,g,b; };
  static const RGB BAUD_COLORS[8] = {
    /*0:白*/ {10,10,10},
    /*1:緑*/ { 0,10, 0},
    /*2:青*/ { 0, 0,10},
    /*3:水*/ { 0,10,10},
    /*4:黄*/ {10,10, 0},
    /*5:橙*/ {10, 3, 0},
    /*6:紫*/ {10, 0,10},
    /*7:赤*/ {10, 0, 0}
  };

  //─────────────────
  // 初期化処理
  //----------------------------------
  // 実行元：mmp.ino - setup()
  //─────────────────
  bool InitSerial(){

    // ボーレート設定ボタンのピンを定義
    pinMode(SW_PIN_A, INPUT_PULLUP);
    pinMode(SW_PIN_B, INPUT_PULLUP);
    pinMode(SW_PIN_C, INPUT_PULLUP);
    delay(10);

    // ボタンを読取
    int A = (digitalRead(SW_PIN_A) == LOW) ? 1 : 0;
    int B = (digitalRead(SW_PIN_B) == LOW) ? 1 : 0;
    int C = (digitalRead(SW_PIN_C) == LOW) ? 1 : 0;

    //ボーレートIDを取得
    int id = 7;
    if      (A==0 && B==0 && C==0) id = 0;
    else if (A==1 && B==0 && C==0) id = 1;
    else if (A==0 && B==1 && C==0) id = 2;
    else if (A==0 && B==0 && C==1) id = 3;
    else if (A==1 && B==1 && C==0) id = 4;
    else if (A==0 && B==1 && C==1) id = 5;
    else if (A==1 && B==0 && C==1) id = 6;

    // ボーレートに応じてRGB-LEDを点灯
    RGB c = BAUD_COLORS[id]; // 色パターンを取得
    ctx.pixels->begin();     // RGB-LEDを点灯
    ctx.pixels->clear();
    ctx.pixels->setPixelColor(0, ctx.pixels->Color(c.g, c.r, c.b));
    ctx.pixels->show();

    // シリアルポートを起動
    Serial.begin(BAUD_PRESETS[id]);                       // USB(CDC)
    Serial.setDebugOutput(false);                         // SDKデバッグ出力を抑止
    Serial1.begin(BAUD_PRESETS[id], SERIAL_8N1, 44, 43);  // GPIO Serial
    delay(100);
    Serial.flush();
    Serial1.flush();
    delay(100);
  
    // 起動メッセージを表示
    Serial.println("[Serial initialize]"  );
    Serial.println("　USB (CDC)      : OK");
    Serial.println("　UART(GPIO 0,1) : OK");

    return true;
  } // InitSerial()


//========================================================
// メイン処理
//========================================================
namespace {
//━━━━━━━━━━━━━━━━━
// ネームスペース資源(宣言)
//━━━━━━━━━━━━━━━━━
  //─────────────────
  // 基本情報
  //─────────────────
  static const int ROUTE_ID = ROUTE_ID_SERIAL ; // 通信経路のID
  static SLOT_STREAM* ssTBL = nullptr         ; // ユーザ受付資源

//━━━━━━━━━━━━━━━━━
// 接続管理
//━━━━━━━━━━━━━━━━━
  //─────────────────
  // スロットを開放
  //─────────────────
  //　➡【該当処理なし】

  //─────────────────
  // スロットを開放(キー：認証コード)
  //─────────────────
  //　➡【該当処理なし】

  //─────────────────
  // 空きスロットを照会
  //─────────────────
  //　➡【該当処理なし】

  //─────────────────
  // 接続管理TBLを作る
  //----------------------------------
  // 戻り値：なし
  //─────────────────
  void CREATE_SS_TBL(){
  //┬
  //○領域サイズをセット
  int maxCount = PORTS_SERIAL;  // シリアルポート総数
  //│
  //○領域を確保
  ssTBL = new SLOT_STREAM[maxCount];
  //│
  //◎┐TBL全体を初期化
  for (int id = 0; id < maxCount; id++) INIT_SLOT_STREAM(ssTBL[id]);
    //●このスロットを初期化
    //┴
  //┴
  } /* CREATE_SS_TBL() */

  //─────────────────
  // 接続を接続スロットに割り当てる
  //----------------------------------
  // 開始処理で「一度だけ」実行すること
  //─────────────────
  void ATTACH_SS_SLOT(){
  //┬
  //○スロットに[USB-CDC]接続を登録
  ssTBL[0].used  = true     ; // 使用中をセット
  ssTBL[0].conn  = &Serial  ; // 接続を登録
  ssTBL[0].usrID = 0        ; // 固有のユーザIDをセット
  //│
  //○スロットに[UART1]接続を登録
  ssTBL[1].used  = true     ; // 使用中をセット
  ssTBL[1].conn  = &Serial1 ; // 接続を登録
  ssTBL[1].usrID = 1        ; // 固有のユーザIDをセット
  //┴
  } /* ATTACH_SS_SLOT() */

  //─────────────────
  // データ送信
  //─────────────────
  void SEND_CONN(
    SLOT_STREAM&  argSS  , // 送信先
    const String& argMSG   // 送信メッセージ
  ){
  //┬
  //○メッセージをレスポンス
  argSS.conn->print(argMSG);
  //┴
  } /* SEND_CONN() */


//━━━━━━━━━━━━━━━━━
// ルート別の処理
//----------------------------------
// 実行元：mmp.ino - loop()
//----------------------------------
// ルーティング先は１つ(MMPコマンド)
// ロジックで明示的に呼び出す..handle()を参照
//━━━━━━━━━━━━━━━━━
  //─────────────────
  // ルート０：ホスト直下
  //─────────────────
  //　➡【該当処理なし】

  //─────────────────
  // ルート１：ＭＭＰコマンド
  //----------------------------------
  // 引数：
  // (参)接続管理スロット
  //----------------------------------
  //【物理接続型】
  // シリアルの各物理ポートを1ユーザとして扱う。
  // 通信状態は継続的に保持する。
  // 常時接続のため、認証は行わない。
  //----------------------------------
  //・フレーム書式 ：コマンドパス!
  //・状態管理     ：各シリアル経路ごとに1スロット
  //・認証機能
  //　├ 接続スロット：あり(経路に固定)
  //　└ 認証コード  ：なし
  //─────────────────
  void routeMMP(SLOT_STREAM& argSS){
  //┬
  //○┐０．前処理
    //○0-1.処理継続可否を確認
    //　➡【該当処理なし】※常時接続の物理ポートなので確認は不要
    //│
    //○0-2.準備完了フラグを用意
    bool isReady = false;
    //┴
  //│
  //◎┐１．受信待ちデータの取り込み
  while (argSS.conn->available()){
    //○1-1.取り込みの継続を確認
    // ＼（受信待ちデータがない場合）
      //▼取り込みを終了
    //│
    //○1-2.受信データを受信バッファに加える
    char ch = (char)argSS.conn->read(); // ※バイト単位
    if (argSS.rx.length() < SS_RX_SIZE) {argSS.rx += ch;}
    else {
    // ＼（受信バッファが許容サイズを超過した場合）
      //○データ容量超過状態へ移行
      //○受信バッファの内容を破棄
      //▼ルーティング処理を中断
      //  ※残りの受信待ちデータは次回のルーティングで処理される
      argSS.isOverflow = true;
      argSS.rx         = "";
      return;
    } /*【1-2.受信データを受信バッファに加える】*/
    //│
    //◇┐1-3.フレームの完成を確認
    if (ch == '!') {
      //├→（コマンド終端を検出した場合）
        //●オーバーフローを確認
        if (argSS.isOverflow) {
        // ＼（オーバーフロー中の場合）
          //○データ容量超過状態を解除
          //○受信バッファをクリア
          //●エラーコードをレスポンス
          //▼ルーティング処理を中断
          argSS.isOverflow = false;
          argSS.rx         = ""   ;
          SEND_CONN(argSS, "#DFL!");
          return;
        } /*【1-3-1.オーバーフローを確認】*/
        //│
        //○準備完了フラグを[ON]
        //▼取り込みを終了
        isReady = true;
        break;
      //┴
    } /*【1-3.フレームの完成を確認】*/
    //┴
  } /*【１．受信待ちデータの取り込み】*/
  //│
  //○２．後続処理の継続を判断
  if (!isReady) return;
  // ＼（準備が未完了の場合）
    //▼ルーティング処理を中断
  //│
  //○┐３．事前準備
    //●3-1.受信バッファをURI形式に変換
    FormatURI(argSS.rx);
    //│
    //○┐3-2.事前データを用意
      //○3-2-1.認証コードを取得
      //　➡【該当処理なし】
      //│
      //○3-2-2.コマンドパスを取得
      String cmdPath = argSS.rx; // この経路では受信内容全体を利用
      //┴
    //│
    //○2-3.受信バッファを破棄
    argSS.rx = "";
    //┴
  //│
  //○４．認証を実施
  //　➡【該当処理なし】
  //│
  //○┐５．MMPコマンドを実行
    //●対象ユーザを特定
    //●コマンドパーサーへ処理を移譲
    //●実行結果をレスポンス
    int usrID = argSS.usrID; // ※スロット情報から取得
    String mmpResp = MMP_REQUEST(cmdPath, usrID);
    SEND_CONN(argSS, mmpResp);
    //┴
  //┴
  } /* routeMMP() */

//━━━━━━━━━━━━━━━━━
// ルーティング登録
//----------------------------------
// ロジックで明示的に呼び出す..handle()を参照
//━━━━━━━━━━━━━━━━━
//　➡【該当処理なし】

} /* namespace(匿名) */

//========================================================
// ハンドラ関連処理
//--------------------------------------------------------
// シリアルはセットアップ処理内で事前に初期化している為、
// ここでの通信資源生成はない。
//
// start()
// ├ 空SLOT生成
// └ SLOT割当(物理ポート毎に固定で割り当て)
//--------------------------------------------------------
// handle()
// └ route処理
//========================================================
namespace srvSerial {
  //━━━━━━━━━━━━━━━━━
  // 初期化処理
  //----------------------------------
  // 実行元：mmp.ino - setup()
  //━━━━━━━━━━━━━━━━━
  bool start() {

    // 1) 二重起動防止
    if(ssTBL) return true ; // 接続管理TBLが準備済みか

    // 2) サーバ資源生成
    //　➡【該当処理なし】

    // 3) 接続管理TBLを作成
    CREATE_SS_TBL()       ; // 領域確保
    ATTACH_SS_SLOT()      ; // 常時接続としてスロットを固定

    // 4) ルーティング登録
    //　➡【該当処理なし】

    // 5) サーバ開始
    //　➡【該当処理なし】

    // 6) 正常終了
    return true;
  } /* start() */

  //━━━━━━━━━━━━━━━━━
  // ハンドラ入口（ポーリング入口）
  //----------------------------------
  // 実行元：mmp.ino - loop()
  //━━━━━━━━━━━━━━━━━
  void handle(){

    // 1) 起動チェック
    //　➡【該当処理なし】

    // 2) {新規接続時｜再接続時}の接続管理スロット作成
    //　➡【該当処理なし】

    // 3) ルーティング処理
    int maxCount = PORTS_SERIAL; // シリアルポート総数
    for (int id = 0; id < maxCount; id++) routeMMP(ssTBL[id]);

  } /* handle() */

} /* namespace srvSerial */
