// filename : adpTcp.h
//========================================================
// 通信アダプタ：ＴＣＰブリッジ
//--------------------------------------------------------
// ・TCP Bridgeサーバの起動
// ・TCP Bridgeのポーリング処理
//   受信→認証開始→認証検証→コマンド実行→結果返却
//--------------------------------------------------------
// Ver 1.1.0 (2026/08/11) α版 
//========================================================
#pragma once
//┬
//■┐インクルード
  //■Arduinoシステム
  //│
  //■ＭＭＰシステム
  #include "adp.h" // 通信アダプタ共通
  //┴
//┴

//─────────────────
// コンテクスト
//─────────────────
extern MmpContext ctx;       // 所在：mmpCtx.h、実装：mmp.ino

//========================================================
// ＴＣＰブリッジ通信アダプター
//========================================================
namespace adpTcp {
//━━━━━━━━━━━━━━━━━
// 基本情報
//━━━━━━━━━━━━━━━━━
  static constexpr int ROUTE_ID = ROUTE_ID_TCP; // 経路IDを定義
  WiFiServer*      ns_ACCEPTOR  = nullptr     ; // ユーザ受付資源を定義

//━━━━━━━━━━━━━━━━━
// ユーザ認証
//━━━━━━━━━━━━━━━━━
  //─────────────────
  // スロット
  //─────────────────
  //　➡【該当処理なし】※常時接続は対象外

//━━━━━━━━━━━━━━━━━
// 接続情報
//━━━━━━━━━━━━━━━━━
  //─────────────────
  // テーブルを宣言
  //─────────────────
  static SLOT_TCP* ssTBL = nullptr;

  //─────────────────
  // 接続情報TBLを作る
  //----------------------------------
  // 戻り値：なし
  //─────────────────
  void SS_CREATE_TBL(){
  //┬
  //○領域を確保
   ssTBL = new SLOT_TCP[SS_SLOTS]; // 標準量
  //│
  //◎┐TBL全体を初期化
  for (int id = 0; id < SS_SLOTS ; id++) INIT_SLOT_TCP(ssTBL[id]);
    //●このスロットを初期化
    //┴
  //┴
  } /* SS_CREATE_TBL() */

  //─────────────────
  // スロットを開放
  //----------------------------------
  // スロットを管理から外す
  //─────────────────
  // 戻り値：なし
  //─────────────────
  void SS_DETACH_SLOT(SLOT_TCP& argSlot){
    if (argSlot.conn) argSlot.conn .stop(); // 接続を切断
    INIT_SLOT_TCP(argSlot);
  } /* SS_DETACH_SLOT() */

  //─────────────────
  // 空きスロットを照会
  //----------------------------------
  // 該当条件：未使用
  //----------------------------------
  // 戻り値：
  // ・0,1,2...：空きスロットのID
  // ・-1：空きスロットが無い
  //─────────────────
  int SS_GET_FREE_ID() {
  //┬
  //◎┐先頭から走査
  for (int id = 0 ; id < SS_SLOTS ; id++) {
    //○次データの捜査を開始
    // ＼（全スロットを走査し終えた場合）
      //▼ループ処理を中断
    //│
    //○スロットを確認
    if (!ssTBL[id].used < 0) return id;
    // ＼（未使用の場合）
      //▼当該スロットIDを返す
  } /* END-for */
    //┴
  //│
  //▼エラーコードを返す(空きスロットがない)
  return -1;
  //┴
  } /* SS_GET_FREE_ID() */


  //─────────────────
  // 接続を登録
  //----------------------------------
  // 戻り値：なし
  //----------------------------------
  // 新たなTCP接続を接続情報下に置く
  // ポーリングで繰り返し実行される
  //─────────────────
  void SS_ATTACH_SLOT(){
  //┬
  //◎┐未管理のTCP接続をMMP管理対象へ登録する
  while (true) {
    //○新規のTCP接続を取得
    //  ※受付待ちキュー内のTCP接続情報を取得
    //  ※取得後、受付待ち状態から管理処理へ移行
    WiFiClient newConn = ns_ACCEPTOR->available();
    if (!newConn) break;
    // ＼（取得に失敗(待ち接続なし)の場合）
      //▼ループ処理を中断
    //│
    //●空きスロットを探す
    int id = SS_GET_FREE_ID();
    if (id < 0) {continue;}
    // ＼（空きスロットがない）
      //▼次を探す
    //│
    //●スロットを初期化
    INIT_SLOT_TCP(ssTBL[id]);
    //│
    //○スロットに新規接続を登録
    ssTBL[id].conn   = newConn       ; // CP接続を登録
    ssTBL[id].conn .setNoDelay(true) ; // TCPパケット遅延制御
    ssTBL[id].used   = true          ; // 仕様通
    //┴
  } // while
  //┴
  } /* SS_ATTACH_SLOT() */


//━━━━━━━━━━━━━━━━━
// レスポンス
//━━━━━━━━━━━━━━━━━
  //─────────────────
  // データ送信
  //─────────────────
  void SEND_CONN(
    SLOT_TCP&     argSS  , // 送信先
    const String& argMSG   // 送信メッセージ
  ){
  //┬
  //○メッセージをレスポンス
  argSS.conn.print(argMSG);
  //┴
  } /* SEND_CONN() */


//━━━━━━━━━━━━━━━━━
// ルーティング処理
//----------------------------------
// 実行元：mmp.ino - loop()
//----------------------------------
// ルーティング先は１つ(MMPコマンド)
// ロジックで明示的に呼び出す..handle()を参照
//━━━━━━━━━━━━━━━━━
  //─────────────────
  // ルート０：ホスト直下
  //─────────────────
    //　➡【該当処理なし】※Webサーバが対象

  //─────────────────
  // ルート１：ＭＭＰコマンド
  //----------------------------------
  // 引数：
  // (参)接続情報スロット
  //----------------------------------
  //【常時接続：切断時スロット開放型】
  //・TCP接続・１スロット(継続型)の構成
  //・通信状態は継続的に保持する
  //・再接続に対応する為、毎回ユーザー認証する
  //----------------------------------
  //【処理フロー】
  //・状態管理       ：conn.connected()
  //・フレーム分割   ：しない
  //・ユーザ認証     ：しない
  //・接続認証       ：しない
  //----------------------------------
  //【処理詳細】
  // 資源            ：WiFiClient (実体)
  // 資源の実体所有  ：する
  // フレーム書式    ：{コマンドパス}!
  // データ受信単位  ：1byte[conn->read()]
  // フレーム化処理  ：する
  // 受信バッファ    ：する ※ポーリング跨ぎにも対応
  // 受信継続判定    ：available()
  // フレーム終端判定：する(データ受信単位で確認)
  //─────────────────
  void routeMMP(SLOT_TCP& argSS){
  //┬
  //○┐０．前処理
    //○0-1.チェックアウトを確認
    if (!argSS.conn.connected()) {
    // ＼（通信断の場合）
      //○スロットを廃棄
      //▼ルーティング処理を中断
      SS_DETACH_SLOT(argSS);
      return; // TCP接続状態
    } // END-if */
    //│
    //○0-2.ワーク変数を用意
    bool isReady = false;
    //│
    //○0-3.コンテクストをセットアップ
    SETUP_CONTEXT();
    //┴
  //│
  //◎┐１．受信待ちデータの取り込み
  while (argSS.conn.available()) {
    //○1-1.取り込みの継続を確認
    // ＼（受信待ちデータがない場合）
      //▼取り込みを終了
    //│
    //○1-2.受信データを受信バッファに加える
    char ch = (char)argSS.conn.read();
    if (argSS.rx.length() < SS_RX_SIZE) {argSS.rx += ch;}
    else {
    // ＼（オーバーフローした場合）
      //○オーバーフロー中へ移行
      //○受信バッファの内容を破棄
      //▼ルーティング処理を中断
      //  ※残りの受信待ちデータは次回のルーティングで処理される
      argSS.isOverflow = true;
      argSS.rx         = "";
      return;
    } /*【1-2.受信データを受信バッファに加える】*/
    //│
    //◇┐1-3.フレームの完成を確認
    if (ch == '!') {
      //├→（コマンド終端を検出した場合）
        //○オーバーフローを確認
        if (argSS.isOverflow) {
        // ＼（オーバーフロー中の場合）
          //○オーバーフロー中を解除
          //○受信バッファを破棄
          argSS.isOverflow = false;
          argSS.rx         = ""   ;
          //│
          //●エラーコードをレスポンス
          //▼ルーティング処理を中断
          SEND_CONN(argSS, "#DFL!");
          return;
        } /*【1-3-1.オーバーフローを確認】*/
        //│
        //○準備完了フラグを[ON]
        //▼取り込みを終了
        isReady = true;
        break;
      //└┐
        //┴
    } /*【1-3.フレームの完成を確認】*/
    //┴
  } /*【１．受信待ちデータの取り込み】*/
  //│
  //○２．後続処理の継続を判断
  if (!isReady) return;
  // ＼（準備が未完了の場合）
    //▼ルーティング処理を中断
  //│
  //○┐３．事前準備
    //●3-1.受信バッファをURI形式に変換
    //○3-2.事前データを用意
    //○3-3.受信バッファを破棄
    FormatURI(argSS.rx);
    ctx.cmdPath = argSS.rx; // ★CONTEXT更新：コマンドパス
    argSS.rx    = "";
    //┴
  //│
  //○４．認証を実施
  //　➡【該当処理なし】※常時接続は対象外
  //│
  //●５．MMPコマンドを実行→レスポンス
  SEND_CONN(argSS, ADP_RUN());
  //┴
  } /* routeMMP() */


//========================================================
// ポーリング
//========================================================
  //━━━━━━━━━━━━━━━━━
  // 初期化処理
  //----------------------------------
  // ロジックで明示的に呼び出す ※handle()参照
  //━━━━━━━━━━━━━━━━━
  bool start(uint16_t port){

    // 1) 二重起動防止
    if (ns_ACCEPTOR ) return true      ; // サーバの実体化有無を評価

    // 2) サーバ資源生成
    ns_ACCEPTOR = new WiFiServer(port) ; // ユーザ受付に資源をセット

    // 3) 接続情報TBLを作成
    SS_CREATE_TBL()                    ; // 領域確保

    // 4) ルーティング登録
    //　➡【該当処理なし】※Webサーバが対象

    // 5) サーバ開始
    ns_ACCEPTOR->setNoDelay(true)      ; // TCPの遅延を抑制
    ns_ACCEPTOR->begin()               ; // サーバ起動

    // 6) 正常終了
    return true;
  } /* start() */

  //━━━━━━━━━━━━━━━━━
  // ハンドラ入口（ポーリング入口）
  //----------------------------------
  // 実行元：mmp.ino - loop()
  //━━━━━━━━━━━━━━━━━
  void handle(){

    // 1) 起動チェック
    if (!ns_ACCEPTOR ) return; // サーバの実体化有無を評価

    // 2) 経路を指定
    ctx.routeID = ROUTE_ID    ; // ★CONTEXT更新：経路ID

    // 3) 新規接続のスロットを登録
    SS_ATTACH_SLOT();

    // 4) ルーティング処理
    for (int id = 0; id < PORTS_SERIAL; id++) {
      ctx.slotID = id;     // ★CONTEXT更新：スロットID
      routeMMP(ssTBL[id]); // MMPコマンドへルーティング
    }
  } /* handle() */

} /* namespace adpTcp */
