// filename : adpSerial.h
//========================================================
// 通信アダプタ：シリアル
//--------------------------------------------------------
//【常時接続・切断時スロット維持型】
//・基本処理      ：受信→コマンド実行→結果返却
//・スロット構成  ：物理ポート毎に１スロットを占有
//・ポーリング跨ぎ：対応 ※通信状態は継続的に保持
//・認証          ：常時接続のため、認証は行わない
//--------------------------------------------------------
// Ver 1.0.1 (2026/08/05) α版 
//========================================================
#pragma once
//┬
//■┐インクルード
  //■Arduinoシステム
  //│
  //■ＭＭＰシステム
  #include "adp.h" // 通信アダプタ共通
  //┴
//┴

//─────────────────
// コンテクスト
//─────────────────
extern MmpContext ctx;       // 所在：mmpCtx.h、実装：mmp.ino

//========================================================
// シリアル通信アダプター
//========================================================
namespace adpSerial {
//━━━━━━━━━━━━━━━━━
// 基本情報
//━━━━━━━━━━━━━━━━━
  static constexpr int ROUTE_ID = ROUTE_ID_SERIAL; // 経路IDを定義

//━━━━━━━━━━━━━━━━━
// ユーザ認証
//━━━━━━━━━━━━━━━━━
  //─────────────────
  // スロット
  //─────────────────
  //　➡【該当処理なし】※常時接続は対象外

//━━━━━━━━━━━━━━━━━
// 接続情報
//━━━━━━━━━━━━━━━━━
  //─────────────────
  // スロット
  //----------------------------------
  // 資源            ：Stream* (参照)
  // 資源の実体所有  ：しない
  //─────────────────
  static SLOT_STREAM* ssTBL = nullptr; // スロット型を定義

  //─────────────────
  // 接続情報TBLを作る
  //----------------------------------
  // 戻り値：なし
  //─────────────────
  void CREATE_SS_TBL(){
  //┬
  //○領域を確保
  ssTBL = new SLOT_STREAM[PORTS_SERIAL]; // シリアルポート総数
  //│
  //◎┐TBL全体を初期化
  for (int id = 0; id < PORTS_SERIAL; id++) INIT_SLOT_STREAM(ssTBL[id]);
    //●このスロットを初期化
    //┴
  //┴
  } /* CREATE_SS_TBL() */

  //─────────────────
  // スロットを開放
  //─────────────────
  //　➡【該当処理なし】※マルチ接続系が対象

  //─────────────────
  // 空きスロットを照会
  //─────────────────
  //　➡【該当処理なし】※マルチ接続系が対象

  //─────────────────
  // 接続を登録
  //----------------------------------
  // 開始処理で「一度だけ」実行すること
  //─────────────────
  void ATTACH_SS_SLOT(){
  //┬
  //○スロットに[USB-CDC]接続を登録
  ssTBL[0].conn   = &Serial  ; // 接続を登録(既存オブジェクトを指す)
  ssTBL[0].used   = true     ; // 使用中
  //│
  //○スロットに[UART1]接続を登録
  ssTBL[1].conn   = &Serial1 ; // 接続を登録(既存オブジェクトを指す)
  ssTBL[1].used   = true     ; // 使用中
  //┴
  } /* ATTACH_SS_SLOT() */

  //─────────────────
  // 4-2-2.接続認証を実施
  //─────────────────
  //　➡【該当処理なし】※常時接続は対象外

//━━━━━━━━━━━━━━━━━
// レスポンス
//━━━━━━━━━━━━━━━━━
  //─────────────────
  // スロットの受付資源に送信
  //─────────────────
  void SEND_CONN(
    SLOT_STREAM&  argSS  , // 送信先
    const String& argMSG   // 送信メッセージ
  ){
  //┬
  //○メッセージをレスポンス
  argSS.conn->print(argMSG);
  //┴
  } /* SEND_CONN() */

//━━━━━━━━━━━━━━━━━
// プロセス部品
//━━━━━━━━━━━━━━━━━
  //─────────────────
  // １．接続状態を確認
  //----------------------------------
  //【詳細】
  // 常時接続の物理ポートなので確認は不要
  //----------------------------------
  // 戻り値：論理値
  // ・false：接続中
  // ・true ：切断中
  //─────────────────
  bool P1_CONNECT(SLOT_STREAM&  argSS){return false;}

  //─────────────────
  // ２．フレームを取得(データ受信)
  //----------------------------------
  // 受信内容や状況から、受信データの取り込みを継続するかを判定する。
  // 条件(下記3を参照)を満たした場合、フレームをコンテクストに反映する。
  // 1.オーバーフローした場合、フラグ[ON]にセットし、処理継続を不可能と判定する。
  // 2.終端文字でない場合、処理継続を可能と判定する。
  // 3.終端文字を見つけた場合：
  //  ・通常            ：フレームをコンテクストに反映し、処理継続を不可能と判定する。
  //  ・オーバーフロー中：フラグを[OFF]にし、処理継続を不可能と判定する。
  //----------------------------------
  //【詳細】
  // データ受信単位  ：1byte[conn->read()]
  // 受信バッファ    ：する ※ポーリング跨ぎにも対応
  // 受信継続判定    ：する ※オーバーフロー/終端文字/オーバーフロー解除/フレーム完成
  // フレーム終端判定：する ※データ受信単位で確認
  //----------------------------------
  // 戻り値：処理継続の判定（論理値）
  // ・true ：不可能
  // ・false：可能
  //─────────────────
  bool P21_RECEIVE(SLOT_STREAM&  argSS){
  //┬
  //○受信データを受信バッファに加える
  argSS.rx += (char)argSS.conn->read();
  //│
  //○受信バッファのオーバーフローを確認
  if (argSS.rx.length() > SS_RX_SIZE) {
  // ＼（オーバーフローになった場合）
    //○オーバーフロー中へ移行
    //○受信バッファの内容を破棄
    //▼RETURN:不可能(オーバーフローが発生)
    argSS.isOverflow = true;
    argSS.rx         = "";
    return true;
  } /* END-if */
  //│
  //○取り込み状態を確認
  if (!argSS.rx.endsWith("!")) { return false; }
    // ＼（終端に達していない場合）※受信バッファを維持
      //▼RETURN:可能(フレームが未完成)
  //│
  //◇┐理由別に処理
  if (!argSS.isOverflow) {
    //├┐（通常の場合）
      //●受信バッファをURI形式に変換
      //○コンテクストにフレームをセット
      FormatURI(argSS.rx);
      ctx.strFrame = argSS.rx;
    //┴
  } else {
    //└┐
      //○オーバーフロー中を解除
      //●エラーコードをレスポンス
      argSS.isOverflow = false;
      SEND_CONN(argSS, "#DFL!");
      //┴
  } /* END-if */
  //│
  //▼RETURN:不可能
  argSS.rx = "";
  return true;
  //┴
  } /* P21_RECEIVE() */

  //─────────────────
  // ２．フレームを取得
  //----------------------------------
  // フレームの作成状況を判定する。
  //----------------------------------
  //【詳細】
  // フレーム化処理  ：する
  // 受信継続判定    ：する available()
  //----------------------------------
  // 戻り値：フレーム作成状況（論理値）
  // ・true ：未完成
  // ・false：完成
  //─────────────────
  bool P2_MAKE_FRAME(SLOT_STREAM&  argSS){
  //┬
  //◎┐受信待ちデータの取り込み
  while (argSS.conn->available()){
    // ＼（未取り込みデータが空の場合）
      //▼取り込みを終了
    //│
    //●受信バッファに蓄える
    if (P21_RECEIVE(argSS)) break;
    // ＼（継続が不可能と判断されたの場合）
      //▼取り込みを打切り
  } /* END-while */
    //┴
  //│
  //▼処理継続の判定を返す
  return (ctx.strFrame == "" ? true : false);
  //┴
  } /* P2_MAKE_FRAME() */

  //─────────────────
  // ３．フレームから基本情報を取得
  //----------------------------------
  //【詳細】
  // フレーム書式    ：{コマンドパス}!
  //─────────────────
  void P3_MAKE_INFO(){
  //┬
  //〇受信待ちデータの取り込み
  ctx.cmdPath = ctx.strFrame; // ★CONTEXT更新：コマンドパス
  //┴
  } /* P3_MAKE_INFO() */

  //─────────────────
  // ４．認証を実施
  //----------------------------------
  //【詳細】
  // 常時接続のため、認証は行わない
  //----------------------------------
  // 戻り値：論理値
  // ・false：認証に成功
  // ・true ：認証に失敗
  //─────────────────
  bool P4_AUTH(){return false;}


//━━━━━━━━━━━━━━━━━
// ルーティング処理
//----------------------------------
// handle()で明示的に呼び出す
//━━━━━━━━━━━━━━━━━
  //─────────────────
  // ルート１：ＭＭＰコマンド
  //----------------------------------
  // 引数：
  // (参)接続情報スロット
  //─────────────────
  void routeMMP(SLOT_STREAM& argSS){
  //┬
  //○１．接続状態を確認
  if (P1_CONNECT(argSS)) return;
    // ＼（切断の場合）
      //▼処理を中断
  //│
  //●２．フレームを取得
  if (P2_MAKE_FRAME(argSS)) return;
    // ＼（フレームが未完成の場合）
      //▼処理を中断
  //│
  //○３．フレームから基本情報を取得
  P3_MAKE_INFO();
  //│
  //○４．認証を実施
  if (P4_AUTH()) return;
    // ＼（認証に失敗した場合）
      //▼処理を中断
  //│
  //●５．MMPコマンドを実行
  String resMMP = P5_RUN();
  //│
  //●６．実行結果をレスポンス
  SEND_CONN(argSS, resMMP);
  //┴
  } /* routeMMP() */

  //─────────────────
  // ルート０：ホスト直下
  //─────────────────
  //　➡【該当処理なし】※Webサーバが対象

//========================================================
// ポーリング
//========================================================
  //━━━━━━━━━━━━━━━━━
  // 初期化処理
  //----------------------------------
  // 実行元：iniSerial.h - InitSerial()
  //━━━━━━━━━━━━━━━━━
  bool start() {

    // 1) 二重起動防止
    if(ssTBL) return true ; // 接続情報TBLの状況を評価

    // 2) サーバ資源生成
    //　➡【該当処理なし】※セットアップ処理で事前に初期化済み

    // 3) 接続情報TBLを作成
    CREATE_SS_TBL()       ; // 領域確保
    ATTACH_SS_SLOT()      ; // 常時接続スロットを登録

    // 4) ルーティング登録
    //　➡【該当処理なし】※Webサーバが対象

    // 5) サーバ開始
    //　➡【該当処理なし】※ネットワーク系が対象

    // 6) 正常終了
    return true;
  } /* start() */

  //━━━━━━━━━━━━━━━━━
  // ハンドラ入口（ポーリング入口）
  //----------------------------------
  // 実行元：mmp.ino - loop()
  //━━━━━━━━━━━━━━━━━
  void handle(){

    // 1) 起動チェック
    if(!ssTBL) return; // 接続情報TBLの状況を評価

    // 2) 新規接続のスロットを登録
    //　➡【該当処理なし】※start()で登録済み

    // 3) ルーティング処理
    for (int slotID = 0; slotID < PORTS_SERIAL; slotID++) {
      ADP_SETUP_CTX(ROUTE_ID, slotID); // コンテクストをセットアップ
      routeMMP(ssTBL[slotID])        ; // MMPコマンドへルーティング
    }
  } /* handle() */

} /* namespace adpSerial */