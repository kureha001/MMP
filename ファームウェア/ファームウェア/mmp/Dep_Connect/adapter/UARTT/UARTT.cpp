// filename : Dep_Connect/adapter/UARTT/UARTT.cpp
//========================================================
// 接続部門／担当：UART 高速型（ベース）
//--------------------------------------------------------
// Ver 1.4.0 (2026/09/29)
//========================================================

//━━━━━━━━━━━━━━━━━━━━━━━━━━━━
// クラス【基本型】
//━━━━━━━━━━━━━━━━━━━━━━━━━━━━
class  AD_UART : // 接続識別子：Stream*
public AD_API<Stream*> // 基本型
{
private:
//========================================================
//§接続管理
//========================================================
  //───────────────────────────
  // 基本情報
  //───────────────────────────
  Stream* CONN = &Serial; // USB(CDC)だけをセット

//========================================================
//§最終処理
//========================================================
  //───────────────────────────
  // 終了処理：接続元にレスポンスMSGを送信する
  //───────────────────────────
  void SEND_CONN(Stream* argConn) override final {
    //┬
    //○クライアントにレスポンス
    //●ログ出力
    argConn->print(ctx.base.Msg);
    adpFnBase::SHOW_LOG();
    //┴
  } /* SEND_CONN() */

//========================================================
//§ モード別実装のインクルード
//========================================================
#if (MODE == MODE_BRIDGE)
  #include "UART_Bridge.cpp"
#endif

//========================================================
//§公開機能
//========================================================
public:
  //━━━━━━━━━━━━━━━━━━━━━━━━━━━
  // コンストラクタ【基本型】
  //━━━━━━━━━━━━━━━━━━━━━━━━━━━
  AD_UART(MmpContext& argCtx) : // 接続識別子：なし
  AD_API<Stream*>(argCtx, AID::UART) // 基本型
  {
    //┬
    //○メッセージ表示
    Log::prtln(" [OK] UART Hi-Speed / USB(CDC) only");
    //┴
  } /* constractor AD_UART() */

  //━━━━━━━━━━━━━━━━━━━━━━━━━━━
  // ポーリング用ハンドラ
  //━━━━━━━━━━━━━━━━━━━━━━━━━━━
  void handle() override final {
  //┬
  //○┐【前処理】
    //●ハンドル前処理(一般)
    if (SETUP_NORMAL()) return;
    //│＼（異常の場合）
    //│ ▼終了：早期リターンする
    //│
    //●ブリッジ用
    if (SETUP_BRIDGE()) return;
    //│＼（異常の場合）
    //│ ▼終了：早期リターン
    //┴
  //│
  //○┐【主処理】
    //●ストリームを受信
    String retFrame = adpFnStream::GET_FRAME(*(CONN));
    if (retFrame == "") return;
    //│＼（受信データがない場合）
    //│ ▼終了：早期リターンする
    //│
    //●フレームに従いコンテキストを初期化する
    adpFnBase::SETUP_CTX(MY_AID, retFrame);
    //│
//──────────────────
//➡メイン
//・モード別の主処理
#if   (MODE == MODE_MAIN)
//------------------------------------
    //●コマンドを実行
    //●実行結果をレスポンス
    modeMain::RUN();
    SEND_CONN(CONN);
    //┴
//──────────────────
//➡サブ
//・モード別の主処理
#elif (MODE == MODE_SUB)
//------------------------------------
    //●コマンドを実行
    //●実行結果をレスポンス
    modeSub::RUN();
    SEND_CONN(CONN);
    //┴
//──────────────────
//➡ブリッジ
//・モード別の主処理
#elif (MODE == MODE_BRIDGE)
//------------------------------------
    //●ブリッジ処理を実行
    modeBridge::RUN(0, retFrame);
    //│
    //◇┐進捗開始／即時応答 で分岐処理する
    if (ctx.base.Msg == "") {
      //├┐（即時応答ではない場合）
        //○進捗状況を[依頼中]に遷移する
        Log::Outln("1.待機中→依頼中");
        ctx.trans.Stat = BSTAT::REQ;
        //┴
      } else SEND_CONN(CONN);
      //└┐（その他）
        //●接続元にレスポンスMSGを送信する
        //┴
    //│
    //▼終了：早期リターンする ※1件ずつ処理
    return;
//------------------------------------
#endif //➡マスタ｜➡サブ｜➡ブリッジ
//──────────────────
  //│
  //○┐【後処理】
  //┴┴
  } /* handle() */

}; /* class AD_UART */