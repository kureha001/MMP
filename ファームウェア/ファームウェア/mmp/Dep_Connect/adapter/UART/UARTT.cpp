// filename : Dep_Connect/adapter/UART/UARTT.cpp
//========================================================
// 接続部門／担当：UART 高速型（ベース）
//--------------------------------------------------------
// Ver 1.4.0 (2026/09/30)
//========================================================

//━━━━━━━━━━━━━━━━━━━━━━━━━━━━
// クラス【基本型】
//━━━━━━━━━━━━━━━━━━━━━━━━━━━━
class  AD_UART : // 接続識別子：Stream*
public AD_API<Stream*> // 基本型
{
private:
//========================================================
//§接続管理
//========================================================
  //───────────────────────────
  // 基本情報
  //───────────────────────────
  Stream* CONN = &Serial; // USB(CDC)だけをセット

//========================================================
//§最終処理
//========================================================
  //───────────────────────────
  // 終了処理：接続元に処理結果を送信する
  //───────────────────────────
  void SEND_RESULT(Stream* argConn) override final {
    //┬
    //○接続元に処理結果を送信する
    //●コンテクスト・ログを出力する
    argConn->print(ctx.base.Result);
    adpFnBase::LOG_CTX();
    //┴
  } /* SEND_RESULT() */

//========================================================
//§ モード別実装のインクルード
//========================================================
#if MODE == MODE_BRIDGE
  #include "UART_Bridge_Base.cpp"
#endif

//========================================================
//§公開機能
//========================================================
public:
  //━━━━━━━━━━━━━━━━━━━━━━━━━━━
  // コンストラクタ【基本型】
  //━━━━━━━━━━━━━━━━━━━━━━━━━━━
  AD_UART(MmpContext& argCtx) : // 接続識別子：なし
  AD_API<Stream*>(argCtx, AID::UART) // 基本型
  {
    //┬
    //●起動ログMSGを表示する
    Log::prtln(" [OK] UART Hi-Speed / USB(CDC) only");
    //┴
  } /* constractor AD_UART() */

  //━━━━━━━━━━━━━━━━━━━━━━━━━━━
  // ポーリング用ハンドラ
  //━━━━━━━━━━━━━━━━━━━━━━━━━━━
  void handle() override final {
  //┬
  //○┐【前処理】
    //●ハンドル前処理(一般)
    if (SETUP_NORMAL()) return;
    //│＼（進行不可の場合）
    //│ ▼終了：早期リターンする
    //│
  //──────────────────
  //➡ブリッジモード
  #if MODE == MODE_BRIDGE
  //------------------------------------
    //●ブリッジ用
    if (SETUP_BRIDGE()) return;
    //│＼（進行不可の場合）
    //│ ▼終了：早期リターン
  //------------------------------------
  #endif //➡ブリッジ
  //──────────────────
    //┴
  //│
  //○┐【主処理】
    //●フレームを求める
    String retFrame = adpFnStream::GET_FRAME(*(CONN));
    if (retFrame == "") return;
    //│＼（受信データがない場合）
    //│ ▼終了：早期リターンする
    //│
    //●コンテキストを更新する
    adpFnBase::SETUP_CTX(
      MY_AID,   // 通信アダプタID
      0,        // 接続スロットID(ダミー値)
      retFrame  // 求めたフレーム
    );
    //│
//──────────────────
//➡メイン
#if   MODE == MODE_MAIN
//------------------------------------
    //●メインモードの主処理を実行する
    //●実行結果をレスポンス
    modeMain::RUN();
    SEND_RESULT(CONN);
    //┴
//──────────────────
//➡サブ
#elif MODE == MODE_SUB
//------------------------------------
    //●サブモードの主処理を実行する
    //●実行結果をレスポンス
    modeSub::RUN();
    SEND_RESULT(CONN);
    //┴
//──────────────────
//➡ブリッジモード
#elif MODE == MODE_BRIDGE
//------------------------------------
    //●ブリッジモードの主処理を実行する
    //▼終了：早期リターンする ※1件ずつ処理
    this->BRIDGE_PROCESS();
    return;
//------------------------------------
#endif //➡マスタ｜➡サブ｜➡ブリッジ
//──────────────────
  //│
  //○┐【後処理】
  //┴┴
  } /* handle() */

}; /* class AD_UART */