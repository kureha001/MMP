// filename : Dep_Connect/template/api_queue.h
//========================================================
// 接続部門／業務設計：抽象基底クラス（非同期キュー型）
//--------------------------------------------------------
// Ver 1.4.0 (2026/09/27)
//========================================================
#pragma once

//========================================================
// モード処理係（前方宣言）
//========================================================
namespace modeMain   { void RUN(); }
namespace modeSub    { void RUN(); }
namespace modeBridge { void RUN(); }

//━━━━━━━━━━━━━━━━━━━━━━━━━━━━
// クラス：基本型
//━━━━━━━━━━━━━━━━━━━━━━━━━━━━
template <typename T>
class          AD_API_Queue:
virtual public AD_API
{
protected:
//========================================================
//§非同期キュー処理
//========================================================
  //───────────────────────────
  // 基本情報
  //───────────────────────────
  struct QueueItem {
    T      conn ; // 接続識別子 (uint8_t, WiFiClient, String 等)
    String frame; // 受信データフレーム
    int    QID  ; // キューのスロットID
  };
  std::queue<QueueItem> rxQueue;
  std::mutex            queueMutex;

  //───────────────────────────
  // リクエストDSにキューを追加する
  //───────────────────────────
  void pushQueue(
    const T&      conn , // 接続識別
    const String& frame, // フレーム
    const int     SID    // スロットID ※対象外はダミー値をセット
  ) {
    String msg = "["+ String(this->MY_AID) + "] push:" + frame;
    Log::Outln(msg);

    if (frame.length() < 1) return;
    std::lock_guard<std::mutex> lock(queueMutex);
    rxQueue.push({conn, frame, SID});
  } /* pushQueue() */

  //───────────────────────────
  // リクエストDSからのキューを取り出す
  //───────────────────────────
  bool popQueue(QueueItem& outItem) {
    //┬
    //○┐【前処理】
      //┴
    //│
    //○┐【主処理】
      std::lock_guard<std::mutex> lock(queueMutex);
      if (rxQueue.empty()) return false;
      //│
      outItem = rxQueue.front();
      rxQueue.pop();
      //┴
    //│
    //○┐【後処理】
      String msg = "[" + String(this->MY_AID) + "] pop :" + outItem.frame;
      Log::Outln(msg);
      //│
      return true;
    //┴┴
  } /* popQueue() */

//========================================================
//§リクエスト終了
//※通信アダプタで実装する
//========================================================
//──────────────────
//➡ブリッジ
//・転送受付で完了
#if (MODE == MODE_BRIDGE)
//------------------------------------
  //───────────────────────────
  // 転送依頼を受け付ける
  //───────────────────────────
//──────────────────
//➡ブリッジ以外
//・接続元へのレスポンスで完了
#else
//------------------------------------
  //───────────────────────────
  // 接続元にMSGをレスポンスする
  //───────────────────────────
  virtual void SEND_CONN(T argConn) {};
//------------------------------------
#endif //➡ブリッジ｜➡ブリッジ以外
//──────────────────

//========================================================
//§受信処理
//※通信アダプタで実装する
//========================================================

//========================================================
//§ハンドルの事前処理と進行判定
//========================================================
  //───────────────────────────
  // 一般用
  //※通信アダプタで実装する
  //───────────────────────────

//──────────────────
//➡ブリッジ
//・転送処理はブリッジ固有の機能
#if (MODE == MODE_BRIDGE)
//------------------------------------
  //───────────────────────────
  // ブリッジ用：スレーブ
  //※マスタの通信アダプタは更に実装する
  //------------------------------------------------------
  //【戻り値】進行判定
  // true ：進行NG
  // false：進行OK
  //───────────────────────────
  bool SETUP_BRIDGE() override {
    //┬
    //○┐【前処理】
      //○(処理なし)
      //┴
    //│
    //○┐【主処理】
      //●前処理(スレーブ)を実施...進行判定を得る
      bool retGo = modeBridge::SLAVE(
        this->MY_AID,                // 通信アダプタID
        [this](){this->TRANS();} // 転送処理(関数をラムダ式で包む)
      );
      //┴
    //│
    //○┐【後処理】
      //▼返却：正常終了(進行判定)
      return retGo;
    //┴
  } /* SETUP_BRIDGE() */
//------------------------------------
#endif //➡ブリッジ
//──────────────────

//========================================================
//§公開機能
//========================================================
public:
  //━━━━━━━━━━━━━━━━━━━━━━━━━━━
  // コンストラクタ
  // ※通信アダプタで実装する
  //━━━━━━━━━━━━━━━━━━━━━━━━━━━
  AD_API_Queue(MmpContext& context, int aid):
  AD_API(context, aid)
  {}

  //━━━━━━━━━━━━━━━━━━━━━━━━━━━
  // ポーリング用ハンドラ
  //━━━━━━━━━━━━━━━━━━━━━━━━━━━
  void handle() override final {
    //┬
    //○┐【前処理】
      //●一般用
      if (this->SETUP_NORMAL()) return;
      //│＼（異常の場合）
      //│ ▼終了：早期リターン
  //──────────────────
  //➡ブリッジ
  //・転送処理はブリッジ固有の機能
  #if (MODE == MODE_BRIDGE)
  //------------------------------------
      //│
      //●ブリッジ用
      if (SETUP_BRIDGE()) return;
      //│＼（異常の場合）
      //│ ▼終了：早期リターン
  //------------------------------------
  #endif //➡ブリッジ
  //──────────────────
      //┴
    //│
    //○┐【主処理】
      //◎┐キューの自動消化とルーティング
      QueueItem popDat;
      while (popQueue(popDat)) {
        //│＼（キューが空の場合）
        //│ ▼完了：ルーティングを終了
        //│
        //●コンテキストを初期化
        adpFnBase::SETUP_CTX(this->MY_AID, popDat.frame);
        //│
  //──────────────────
  //➡ブリッジ以外
  //・ブリッジではエラーCDもそのまま扱う
  #if (MODE != MODE_BRIDGE)
  //-----------------------------------------
        //○フレームの状態を確認
        if (ctx.base.Frame.startsWith("#")) {this->SEND_CONN(popDat.conn); continue;}
        //│＼（フレームが[エラーCD]の場合）
        //│ ●ブリッジ元にレスポンス
        //│ ▽次へ：次のキューを走査
  //------------------------------------
  #endif //➡ブリッジ以外
  //──────────────────
        //│
  //──────────────────
  //➡メイン
  //・モード別の主処理
  #if   (MODE == MODE_MAIN)
  //------------------------------------
        //●コマンドを実行
        //●実行結果をレスポンス
        modeMain::RUN();
        this->SEND_CONN(popDat.conn);
        //┴
  //──────────────────
  //➡サブ
  //・モード別の主処理
  #elif (MODE == MODE_SUB)
  //------------------------------------
        //●コマンドを実行
        //●実行結果をレスポンス
        modeSub::RUN();
        this->SEND_CONN(popDat.conn);
        //┴
  //──────────────────
  //➡ブリッジ
  //・モード別の主処理
  #elif (MODE == MODE_BRIDGE)
  //------------------------------------
        //◇┐ブリッジ種別(マスタ／スレーブ)別の処理に進行する。
        if (ctx.trans.Stat == BSTAT::IDLE && ctx.base.AID == AID::UART) {
          //├┐（[待機中]かつ[マスタ]の場合）
            //●ブリッジ処理を実行
            modeBridge::RUN(popDat.QID, popDat.frame);
            if (ctx.base.Msg != "") {this->SEND_CONN(popDat.conn); return;}
            //│＼（[内部コマンド応答済][エラーあり]の場合）
            //│ ○クライアントにレスポンス
            //│ ▼終了：早期リターン
            //│
            //○進捗状況を[依頼中]に遷移
            //▼終了：早期リターン ※1件ずつ処理
            Log::Outln("1.待機中→依頼中");
            ctx.trans.Stat  = BSTAT::REQ;
            return;

        } else if (ctx.trans.Stat == BSTAT::BUSY && this->MY_AID == ctx.trans.AID) {
          //├┐（[処理中]かつ[スレーブ] の場合）
            //○レスポンスMSGに[フレーム内容]をセット
            //○進行状況を[処理済]に遷移
            //▼終了：早期リターン ※1件ずつ処理
            Log::Outln("3.処理中→処理済(キュー)");
            ctx.base.Msg   = ctx.base.Frame;
            ctx.trans.Stat = BSTAT::DONE;
            return;
          //└┐（その他）
            //○なにもしない（キューは空振りになる）
            Log::Outln("0.空振り(キュー)");
            //┴
        } //～if
        //┴
  //------------------------------------
  #endif //➡メイン｜➡サブ｜➡ブリッジ
  //──────────────────
      //┴
    } //～while
    //│
    //○┐【後処理】
      //○（処理なし）
    //┴┴
  } /* handle() */

}; /* class AD_API_Queue */